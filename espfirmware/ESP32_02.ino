#include <array>
#include <cmath>

// Generated by ml/train_tree.py. Synthetic route scenario model; not hardware-trained.
namespace p12ganesh::ml {
inline constexpr const char *MODEL_VERSION = "decision-tree-v1-seed-20261101";
struct RouteFeatures {
    double upper_available, upper_pdr_estimate, upper_latency_ms, upper_hops;
    double lower_available, lower_pdr_estimate, lower_latency_ms, lower_hops;
};
inline std::array<double, 8> values(const RouteFeatures& f) {
    return {f.upper_available, f.upper_pdr_estimate, f.upper_latency_ms, f.upper_hops,
            f.lower_available, f.lower_pdr_estimate, f.lower_latency_ms, f.lower_hops};
}
inline constexpr int feature[21] = {1, 4, -2, 5, 5, -2, -2, -2, 2, 5, 5, -2, -2, 1, -2, -2, 5, 1, -2, -2, -2};
inline constexpr int left[21] = {1, 2, -1, 4, 5, -1, -1, -1, 9, 10, 11, -1, -1, 14, -1, -1, 17, 18, -1, -1, -1};
inline constexpr int right[21] = {8, 3, -1, 7, 6, -1, -1, -1, 16, 13, 12, -1, -1, 15, -1, -1, 20, 19, -1, -1, -1};
inline constexpr double threshold[21] = {0.907467335463, 0.5, -2, 0.865931242704, 0.859115302563, -2, -2, -2, 119.210910797, 0.995044529438, 0.962451845407, -2, -2, 0.984755635262, -2, -2, 0.919160217047, 0.980703085661, -2, -2, -2};
inline constexpr int leaf_label[21] = {1, 1, -1, 1, 1, 1, 1, 1, 0, 0, 0, 0, 0, 1, 1, 0, 1, 0, 1, 0, 1};
inline int predict(const RouteFeatures& input) {
    const auto x = values(input);
    for (double value : x) if (!std::isfinite(value)) return -2;
    int node = 0;
    while (left[node] != -1) node = (x[feature[node]] <= threshold[node]) ? left[node] : right[node];
    return leaf_label[node];
}
inline double expectedCost(double pdr, double latencyMs) {
    return pdr * latencyMs + (1.0 - pdr) * 1000.0;
}
inline bool usable(bool available, double pdr, double latencyMs, double hops) {
    return available && std::isfinite(pdr) && pdr >= 0 && pdr <= 1 &&
           std::isfinite(latencyMs) && latencyMs >= 0 && std::isfinite(hops) && hops >= 1;
}
inline int selectSafely(int prediction, const RouteFeatures& f) {
    const bool upper = usable(f.upper_available >= 0.5, f.upper_pdr_estimate, f.upper_latency_ms, f.upper_hops);
    const bool lower = usable(f.lower_available >= 0.5, f.lower_pdr_estimate, f.lower_latency_ms, f.lower_hops);
    if (prediction == 0 && upper) return 0;
    if (prediction == 1 && lower) return 1;
    if (!upper && !lower) return -1;
    if (!upper) return 1;
    if (!lower) return 0;
    const double upperCost = expectedCost(f.upper_pdr_estimate, f.upper_latency_ms);
    const double lowerCost = expectedCost(f.lower_pdr_estimate, f.lower_latency_ms);
    if (upperCost != lowerCost) return upperCost < lowerCost ? 0 : 1;
    return f.upper_hops <= f.lower_hops ? 0 : 1;
}
} // namespace p12ganesh::ml

// P12-IOT ESP32_02 — independent relay firmware.
#include <Arduino.h>
#include <WiFi.h>
#include <esp_now.h>
#include <esp_wifi.h>
#include <esp_arduino_version.h>
#include <freertos/FreeRTOS.h>
#include <freertos/queue.h>
#include <string.h>
#include <limits.h>

static constexpr char PROJECT_ID[] = "P12-IOT";
static constexpr char NETWORK_ID[] = "P12-MESH-01";
static constexpr char EXPERIMENT_ID[] = "EXP-003";
static constexpr uint8_t PROTOCOL_VERSION = 2;
#define NODE_ID 2
static constexpr uint8_t PACKET_DATA = 1;
static constexpr uint8_t PACKET_ACK = 2;
static constexpr uint8_t PACKET_PATH_PROBE = 3;
static constexpr uint8_t PACKET_PATH_STATUS = 4;
static constexpr uint8_t PACKET_DELIVERY_REPORT = 7;
static constexpr uint8_t PACKET_GATEWAY_PROBE = 5;
static constexpr uint8_t PACKET_GATEWAY_PROBE_ACK = 6;
static constexpr uint8_t PACKET_GATEWAY_BEACON = 8;
static constexpr uint8_t PACKET_CHANNEL_SYNC_REQUEST = 9;
static constexpr uint8_t PACKET_CHANNEL_SYNC_RESPONSE = 10;
static constexpr uint8_t PACKET_CHANNEL_SYNC_ACK = 11;
static constexpr uint8_t PACKET_CHANNEL_CHANGE_NOTICE = 12;
static constexpr uint8_t SYNC_MARKER = 0xD2;
static constexpr uint8_t SYNC_ROUTE_MARKER = 0xC3;
static constexpr uint32_t SYNC_MAGIC = 0x50313243UL;
static constexpr uint32_t CHANNEL_BEACON_INTERVAL_MS = 250UL;
static constexpr uint32_t CHANNEL_SCAN_DWELL_MS = 350UL;
static constexpr uint32_t CHANNEL_SCAN_PAUSE_MS = 250UL;
static constexpr uint32_t CHANNEL_BEACON_TIMEOUT_MS = 1800UL;
static constexpr uint32_t CHANNEL_SYNC_RETRY_MS = 700UL;
static constexpr uint8_t CHANNEL_SYNC_MAX_RETRIES = 4;
static constexpr uint8_t CHANNEL_STATE_SCAN = 0;
static constexpr uint8_t CHANNEL_STATE_WAIT = 1;
static constexpr uint8_t CHANNEL_STATE_SYNCED = 2;
static uint8_t meshChannel = 1, channelState = CHANNEL_STATE_SCAN;
static uint8_t scanFirstChannel = 1, scanLastChannel = 11, scanChannel = 1, syncRetries = 0;
static bool scanCountryAvailable = false;
static uint32_t scanDwellAt = 0, scanPauseAt = 0, lastGatewayBeaconAt = 0;
static uint32_t syncSequence = 0, syncRequestAt = 0, syncNonceUptime = 0, lastSyncAckAt = 0;
static uint8_t gatewayMac[6]{};

static constexpr uint8_t ROUTING_BASELINE_FALLBACK = 1;
static constexpr uint8_t ROUTING_ML_UPPER = 2;
static constexpr uint8_t ROUTING_ML_LOWER = 3;
static constexpr uint8_t ROUTING_NO_VALID_ROUTE = 4;
static constexpr uint8_t GATEWAY_ID = 4;
static constexpr uint8_t MESH_BOOT_CHANNEL = 1;
static constexpr uint8_t MAX_HOPS = 4;
static constexpr uint8_t LIGHT_UNKNOWN = 255;
static constexpr int16_t UNKNOWN_I16 = INT16_MIN;
static constexpr uint16_t UNKNOWN_U16 = UINT16_MAX;
static constexpr uint32_t UNKNOWN_U32 = UINT32_MAX;

struct __attribute__((packed)) MeshPacket {
  uint8_t version;
  uint8_t type;
  char project_id[8];
  char network_id[12];
  char experiment_id[8];
  uint8_t source_id;
  uint8_t destination_id;
  uint8_t next_hop_id;
  uint8_t forwarding_node_id;
  uint8_t routing_algorithm;
  uint32_t sequence;
  uint32_t source_uptime_ms;
  uint8_t hop_count;
  uint8_t hop_limit;
  int16_t temperature_centi_c;
  uint16_t humidity_centi_percent;
  uint8_t light_status;
  uint8_t sound_detected;
  int16_t last_hop_rssi_dbm;
  uint16_t latency_ms;
  uint8_t packet_loss_percent;
  uint32_t throughput_bps;
  uint8_t feature_valid;
  int8_t predicted_class;
  uint8_t route_change;
  uint8_t route_change_reason;
  uint8_t selected_next_hop_id;
  uint32_t source_packets_sent;
  float model_features[8];
};
static_assert(sizeof(MeshPacket) <= 250, "ESP-NOW payload too large");
struct RxFrame { uint8_t mac[6]; MeshPacket packet; int16_t rssi; };
struct SeenKey { uint8_t source; uint32_t sequence; uint32_t uptime; };
struct Neighbor { uint8_t mac[6]; int16_t rssi; uint32_t heard; uint32_t packets; };


static bool isChannelSyncType(uint8_t type);
static bool validChannelSyncPacket(const MeshPacket &p);
static MeshPacket makeChannelSyncPacket(uint8_t type, uint8_t source, uint8_t destination,
                                       uint8_t channel, uint32_t sequence, uint32_t uptime);
static bool sendChannelSyncPacket(const uint8_t *mac, const MeshPacket &p);
static void configureChannelScanRange();
static void startChannelScan(const char *reason);
static void serviceChannelSync();
static bool processChannelSyncFrame(const RxFrame &frame);

static bool addPeer(const uint8_t *mac);
// Keep all declarations after custom types: Arduino may inject prototypes before definitions.
static bool sendBroadcast(const MeshPacket &packet);
static void copyText(char *dst, size_t size, const char *src);
#if ESP_ARDUINO_VERSION_MAJOR >= 3
static void receiveCallback(const esp_now_recv_info_t *info,const uint8_t *data,int len);
static void sendCallback(const wifi_tx_info_t *,esp_now_send_status_t s);
#else
static void receiveCallback(const uint8_t *mac,const uint8_t *data,int len);
static void sendCallback(const uint8_t *,esp_now_send_status_t s);
#endif
static void updateNeighbor(const uint8_t *mac,int16_t rssi);
static void refreshGatewayWindow(uint32_t now);
static bool gatewayPathAvailable(uint32_t now);
static uint8_t gatewayPathLoss();
static void sendPathStatus(const RxFrame &f);
static bool serviceGatewayProbe();
static const char *routingModeName(uint8_t mode);
static void sendAck(const uint8_t *mac,uint8_t previous,uint32_t seq,uint32_t uptime);
static void remember(const MeshPacket &p);
static void processFrame(const RxFrame &f);
static void serviceForward();
static void serviceReceive();
static void requestStatusLED(uint8_t color,uint32_t holdMs);
static void serviceStatusLED(bool errorActive,bool processingActive);
void setup();
void loop();

static constexpr uint8_t BROADCAST_MAC[6] = {0xFF,0xFF,0xFF,0xFF,0xFF,0xFF};
static bool addPeer(const uint8_t *mac) {
  if (esp_now_is_peer_exist(mac)) return true;
  esp_now_peer_info_t peer{};
  memcpy(peer.peer_addr, mac, 6);
  peer.channel = 0;
  peer.ifidx = WIFI_IF_STA;
  peer.encrypt = false;
  return esp_now_add_peer(&peer) == ESP_OK;
}
static bool sendBroadcast(const MeshPacket &packet) {
  return esp_now_send(BROADCAST_MAC, reinterpret_cast<const uint8_t *>(&packet), sizeof(packet)) == ESP_OK;
}
static void copyText(char *dst, size_t size, const char *src) {
  strncpy(dst, src, size - 1);
  dst[size - 1] = '\0';
}

static bool isChannelSyncType(uint8_t type) {
  return type >= PACKET_GATEWAY_BEACON && type <= PACKET_CHANNEL_CHANGE_NOTICE;
}
static bool validChannelSyncPacket(const MeshPacket &p) {
  return p.version == PROTOCOL_VERSION && isChannelSyncType(p.type) &&
    !strncmp(p.project_id, PROJECT_ID, sizeof(p.project_id)) &&
    !strncmp(p.network_id, NETWORK_ID, sizeof(p.network_id)) &&
    !strncmp(p.experiment_id, EXPERIMENT_ID, sizeof(p.experiment_id)) &&
    p.routing_algorithm == SYNC_MARKER && p.feature_valid == 0xA5 &&
    p.predicted_class == -42 && p.route_change == SYNC_ROUTE_MARKER &&
    p.route_change_reason == 0x51 && p.hop_count == 0x5A && p.hop_limit == 0xA5 &&
    p.source_packets_sent == SYNC_MAGIC && p.next_hop_id >= 1 && p.next_hop_id <= 13 &&
    p.selected_next_hop_id == p.next_hop_id;
}
static MeshPacket makeChannelSyncPacket(uint8_t type, uint8_t source, uint8_t destination,
                                        uint8_t channel, uint32_t sequence, uint32_t uptime) {
  MeshPacket p{}; p.version=PROTOCOL_VERSION; p.type=type;
  copyText(p.project_id,sizeof(p.project_id),PROJECT_ID);
  copyText(p.network_id,sizeof(p.network_id),NETWORK_ID);
  copyText(p.experiment_id,sizeof(p.experiment_id),EXPERIMENT_ID);
  p.source_id=source; p.destination_id=destination; p.next_hop_id=channel;
  p.selected_next_hop_id=channel; p.routing_algorithm=SYNC_MARKER; p.sequence=sequence;
  p.source_uptime_ms=uptime; p.hop_count=0x5A; p.hop_limit=0xA5;
  p.feature_valid=0xA5; p.predicted_class=-42; p.route_change=SYNC_ROUTE_MARKER;
  p.route_change_reason=0x51; p.source_packets_sent=SYNC_MAGIC; return p;
}
static bool sendChannelSyncPacket(const uint8_t *mac, const MeshPacket &p) {
  return addPeer(mac) && esp_now_send(mac,reinterpret_cast<const uint8_t*>(&p),sizeof(p))==ESP_OK;
}
static void configureChannelScanRange() {
  wifi_country_t country{};
  scanCountryAvailable=esp_wifi_get_country(&country)==ESP_OK&&country.nchan;
  if (scanCountryAvailable) {
    scanFirstChannel=country.schan;
    scanLastChannel=(uint8_t)min(13,(int)country.schan+(int)country.nchan-1);
  } else { scanFirstChannel=1; scanLastChannel=11; }
  if (scanFirstChannel<1 || scanFirstChannel>13 || scanFirstChannel>scanLastChannel) {
    scanFirstChannel=1; scanLastChannel=11;
  }
  scanChannel=scanFirstChannel;
  Serial.printf("CHANNEL_SCAN_RANGE first=%u last=%u regulatory_source=%s\n",scanFirstChannel,scanLastChannel,scanCountryAvailable?"configured":"world_safe_fallback");
}
static void startChannelScan(const char *reason) {
  meshChannel=scanChannel; channelState=CHANNEL_STATE_SCAN; syncRetries=0;
  scanDwellAt=0; scanPauseAt=millis(); lastGatewayBeaconAt=0;
  Serial.printf("MESH_DISCOVERY_START node=%u channel=%u reason=%s\n",NODE_ID,meshChannel,reason);
}
static bool processChannelSyncFrame(const RxFrame &frame) {
  const MeshPacket &p=frame.packet;
  if (!isChannelSyncType(p.type)) return false;
  if (!validChannelSyncPacket(p) || p.source_id!=GATEWAY_ID ||
      (p.destination_id!=NODE_ID && p.destination_id!=255)) return true;
  uint8_t radioChannel=0; wifi_second_chan_t second;
  if (esp_wifi_get_channel(&radioChannel,&second)!=ESP_OK || radioChannel!=p.next_hop_id) return true;
  if (p.type==PACKET_GATEWAY_BEACON || p.type==PACKET_CHANNEL_CHANGE_NOTICE) {
    lastGatewayBeaconAt=millis();
    if (channelState==CHANNEL_STATE_SYNCED) return true;
    if (channelState==CHANNEL_STATE_SCAN) {
      memcpy(gatewayMac,frame.mac,sizeof(gatewayMac)); meshChannel=p.next_hop_id;
      channelState=CHANNEL_STATE_WAIT; syncRetries=0; syncRequestAt=0;
      Serial.printf("CHANNEL_BEACON_FOUND node=%u channel=%u\n",NODE_ID,meshChannel);
    }
    return true;
  }
  if (p.type==PACKET_CHANNEL_SYNC_RESPONSE && p.destination_id==NODE_ID &&
      channelState==CHANNEL_STATE_WAIT && p.sequence==syncSequence && p.source_uptime_ms==syncNonceUptime &&
      memcmp(frame.mac,gatewayMac,sizeof(gatewayMac))==0) {
    channelState=CHANNEL_STATE_SYNCED; meshChannel=p.next_hop_id;
    lastGatewayBeaconAt=millis(); syncRetries=0; lastSyncAckAt=millis();
    MeshPacket ack=makeChannelSyncPacket(PACKET_CHANNEL_SYNC_ACK,NODE_ID,GATEWAY_ID,meshChannel,syncSequence,syncNonceUptime);
    sendChannelSyncPacket(gatewayMac,ack);
    Serial.printf("NODE_CHANNEL_SYNC node=%u channel=%u result=success\n",NODE_ID,meshChannel);
    return true;
  }
  return true;
}
static void serviceChannelSync() {
  uint32_t now=millis();
  if (channelState==CHANNEL_STATE_SYNCED && now-lastGatewayBeaconAt>CHANNEL_BEACON_TIMEOUT_MS) {
    Serial.printf("CHANNEL_SYNC_LOST node=%u channel=%u age_ms=%lu reason=beacon_timeout\n",NODE_ID,meshChannel,(unsigned long)(now-lastGatewayBeaconAt));
    startChannelScan("gateway_beacon_timeout");
  }
  if (channelState==CHANNEL_STATE_SYNCED) {
    if (now-lastSyncAckAt>=5000UL) {
      MeshPacket ack=makeChannelSyncPacket(PACKET_CHANNEL_SYNC_ACK,NODE_ID,GATEWAY_ID,meshChannel,syncSequence,syncNonceUptime);
      if (sendChannelSyncPacket(gatewayMac,ack)) lastSyncAckAt=now;
    }
    return;
  }
  if (channelState==CHANNEL_STATE_WAIT) {
    if (now-syncRequestAt>=CHANNEL_SYNC_RETRY_MS) {
      if (syncRetries>=CHANNEL_SYNC_MAX_RETRIES) {
        Serial.printf("CHANNEL_SYNC_FAILED node=%u channel=%u retries=%u reason=response_timeout\n",NODE_ID,meshChannel,syncRetries);
        channelState=CHANNEL_STATE_SCAN; scanDwellAt=now; scanChannel=(meshChannel>=scanLastChannel)?scanFirstChannel:(uint8_t)(meshChannel+1);
        scanPauseAt=now+CHANNEL_SCAN_PAUSE_MS; return;
      }
      ++syncRetries; ++syncSequence; syncNonceUptime=now;
      MeshPacket request=makeChannelSyncPacket(PACKET_CHANNEL_SYNC_REQUEST,NODE_ID,GATEWAY_ID,meshChannel,syncSequence,syncNonceUptime);
      if (!sendChannelSyncPacket(gatewayMac,request)) Serial.printf("CHANNEL_SYNC_RETRY node=%u channel=%u retry=%u reason=send_failed\n",NODE_ID,meshChannel,syncRetries);
      syncRequestAt=now;
    }
    return;
  }
  if (now<scanPauseAt) return;
  if (!scanDwellAt || now-scanDwellAt>=CHANNEL_SCAN_DWELL_MS) {
    uint8_t attempts=0; esp_err_t err=ESP_FAIL;
    while (attempts++<=scanLastChannel-scanFirstChannel) {
      err=esp_wifi_set_channel(scanChannel,WIFI_SECOND_CHAN_NONE);
      if (err==ESP_OK) break;
      scanChannel=(scanChannel>=scanLastChannel)?scanFirstChannel:(uint8_t)(scanChannel+1);
    }
    if (err!=ESP_OK) { Serial.printf("CHANNEL_SCAN_BLOCKED node=%u reason=no_permitted_channels\n",NODE_ID); scanPauseAt=now+1000UL; return; }
    meshChannel=scanChannel; scanDwellAt=now;
    Serial.printf("CHANNEL_SCAN node=%u channel=%u\n",NODE_ID,meshChannel);
    if(scanChannel>=scanLastChannel){
      scanChannel=scanFirstChannel;scanPauseAt=now+CHANNEL_SCAN_PAUSE_MS;
      Serial.printf("CHANNEL_SCAN_CYCLE_COMPLETE node=%u next_scan_after_ms=%lu\n",NODE_ID,(unsigned long)CHANNEL_SCAN_PAUSE_MS);
    }else scanChannel=(uint8_t)(scanChannel+1);
  }
}

#define ESP32_02 "ESP32_02"
#define LED_RED 21
#define LED_YELLOW 22
#define LED_GREEN 23
#define LED_COLOR_RED 1
#define LED_COLOR_YELLOW 2
#define LED_COLOR_GREEN 3
#define LED_SUCCESS_HOLD_MS 700UL
#define LED_ACTIVITY_HOLD_MS 250UL
#define LED_ERROR_HOLD_MS 900UL
#define FORWARD_QUEUE_SIZE 8
#define SEEN_SIZE 32
#define ACK_TIMEOUT_MS 400UL
#define MAX_TRANSMISSIONS 4
#define GATEWAY_PROBE_INTERVAL 2000UL
#define GATEWAY_PROBE_TIMEOUT 500UL
#define GATEWAY_PROBE_WINDOW 30000UL
#define PATH_STATUS_MAX_AGE 6000UL
#define PATH_MIN_SAMPLES 5
static QueueHandle_t rxQueue;
static MeshPacket forwardQueue[FORWARD_QUEUE_SIZE], inFlight{};
static uint8_t qHead=0,qTail=0,qCount=0,seenCursor=0,txAttempts=0;
static SeenKey seen[SEEN_SIZE]{};
static Neighbor neighbors[8]{};
static bool waitingAck=false, macSendFailed=false;
static uint32_t lastSend=0,lastStats=0,rxCount=0,forwarded=0,duplicates=0,failed=0,acked=0,retries=0;
static uint32_t lastAckRtt=0, txCount=0, txFailed=0;
static int16_t lastRssi=UNKNOWN_I16, gatewayRssi=UNKNOWN_I16;
static bool waitingGatewayProbe=false;
static uint32_t gatewayProbeSequence=0,lastGatewayProbe=0,gatewayProbeAt=0,lastGatewaySuccess=0,gatewayWindowStarted=0;
static uint16_t gatewayProbeAttempts=0,gatewayProbeSuccesses=0,gatewayLatencyMs=UNKNOWN_U16;
static uint8_t gatewayPathHops=0;
static uint32_t gatewayLatencyTotal=0;
static uint32_t ledRedUntil=0,ledYellowUntil=0,ledGreenUntil=0;
static bool ledRedOn=false,ledYellowOn=false,ledGreenOn=false;

static void requestStatusLED(uint8_t color,uint32_t holdMs){
  uint32_t until=millis()+holdMs;
  if(color==LED_COLOR_RED)ledRedUntil=until;
  else if(color==LED_COLOR_YELLOW)ledYellowUntil=until;
  else if(color==LED_COLOR_GREEN)ledGreenUntil=until;
}
static void serviceStatusLED(bool errorActive,bool processingActive){
  uint32_t now=millis();
  bool red=errorActive||(int32_t)(ledRedUntil-now)>0;
  bool yellow=!red&&(processingActive||(int32_t)(ledYellowUntil-now)>0);
  bool green=!red&&!yellow&&(int32_t)(ledGreenUntil-now)>0;
  if(red!=ledRedOn)digitalWrite(LED_RED,red?HIGH:LOW);
  if(yellow!=ledYellowOn)digitalWrite(LED_YELLOW,yellow?HIGH:LOW);
  if(green!=ledGreenOn)digitalWrite(LED_GREEN,green?HIGH:LOW);
  ledRedOn=red;ledYellowOn=yellow;ledGreenOn=green;
}
#if ESP_ARDUINO_VERSION_MAJOR >= 3
static void receiveCallback(const esp_now_recv_info_t *info,const uint8_t *data,int len) {
  if(!info||len!=sizeof(MeshPacket))return;
  RxFrame f{}; memcpy(f.mac,info->src_addr,6); memcpy(&f.packet,data,sizeof(MeshPacket));
  f.rssi=info->rx_ctrl?info->rx_ctrl->rssi:UNKNOWN_I16; xQueueSend(rxQueue,&f,0);
}
static void sendCallback(const wifi_tx_info_t *,esp_now_send_status_t s){macSendFailed=s!=ESP_NOW_SEND_SUCCESS;}
#else
static void receiveCallback(const uint8_t *mac,const uint8_t *data,int len) {
  if(len!=sizeof(MeshPacket))return;
  RxFrame f{}; memcpy(f.mac,mac,6); memcpy(&f.packet,data,sizeof(MeshPacket)); f.rssi=UNKNOWN_I16; xQueueSend(rxQueue,&f,0);
}
static void sendCallback(const uint8_t *,esp_now_send_status_t s){macSendFailed=s!=ESP_NOW_SEND_SUCCESS;}
#endif
static void remember(const MeshPacket&p){seen[seenCursor]={p.source_id,p.sequence,p.source_uptime_ms};seenCursor=(seenCursor+1)%SEEN_SIZE;}
static bool seenBefore(const MeshPacket&p){for(const auto&k:seen)if(k.source==p.source_id&&k.sequence==p.sequence&&k.uptime==p.source_uptime_ms)return true;return false;}
static void updateNeighbor(const uint8_t*mac,int16_t rssi){
  lastRssi=rssi;
  int slot=-1,oldest=0;uint32_t oldestTime=UINT32_MAX;
  for(int i=0;i<8;i++){if(neighbors[i].packets&&memcmp(neighbors[i].mac,mac,6)==0){slot=i;break;}if(!neighbors[i].packets){oldest=i;oldestTime=0;}else if(oldestTime&&neighbors[i].heard<oldestTime){oldest=i;oldestTime=neighbors[i].heard;}}
  if(slot<0)slot=oldest;
  if(!neighbors[slot].packets||memcmp(neighbors[slot].mac,mac,6)!=0){memcpy(neighbors[slot].mac,mac,6);neighbors[slot].packets=0;}
  neighbors[slot].rssi=rssi;neighbors[slot].heard=millis();++neighbors[slot].packets;
}
static void refreshGatewayWindow(uint32_t now){
  if(!gatewayWindowStarted||now-gatewayWindowStarted>=GATEWAY_PROBE_WINDOW){
    gatewayWindowStarted=now;gatewayProbeAttempts=gatewayProbeSuccesses=0;gatewayLatencyTotal=0;
    gatewayLatencyMs=UNKNOWN_U16;
  }
}
static bool gatewayPathAvailable(uint32_t now){
  return gatewayProbeAttempts>=PATH_MIN_SAMPLES&&gatewayProbeSuccesses>0&&
         lastGatewaySuccess&&now-lastGatewaySuccess<=PATH_STATUS_MAX_AGE;
}
static uint8_t gatewayPathLoss(){
  return gatewayProbeAttempts>=PATH_MIN_SAMPLES
    ? (uint8_t)(100U-((uint32_t)gatewayProbeSuccesses*100U/gatewayProbeAttempts)) : 255;
}
static void sendPathStatus(const RxFrame&f){
  if(waitingAck||waitingGatewayProbe)return;
  const MeshPacket&request=f.packet;uint32_t now=millis();
  MeshPacket status{};status.version=PROTOCOL_VERSION;status.type=PACKET_PATH_STATUS;
  copyText(status.project_id,sizeof(status.project_id),PROJECT_ID);copyText(status.network_id,sizeof(status.network_id),NETWORK_ID);
  copyText(status.experiment_id,sizeof(status.experiment_id),EXPERIMENT_ID);
  status.source_id=NODE_ID;status.destination_id=1;status.next_hop_id=1;status.forwarding_node_id=NODE_ID;
  status.sequence=request.sequence;status.source_uptime_ms=request.source_uptime_ms;
  // Keep last measured hop count/latency while explicitly reporting current availability.
  status.hop_count=gatewayPathHops?(uint8_t)(1+gatewayPathHops):0;
  // PATH_STATUS feature_valid: 1=up, 0=measured down, 255=not enough probes.
  status.feature_valid=gatewayPathAvailable(now)?1:(gatewayProbeAttempts>=PATH_MIN_SAMPLES?0:255);status.last_hop_rssi_dbm=gatewayRssi;
  status.latency_ms=gatewayLatencyMs;status.packet_loss_percent=gatewayPathLoss();
  if(addPeer(f.mac))esp_now_send(f.mac,reinterpret_cast<const uint8_t*>(&status),sizeof(status));
}
static bool serviceGatewayProbe(){
  if (channelState != CHANNEL_STATE_SYNCED) return false;
  uint32_t now=millis();refreshGatewayWindow(now);
  if(waitingGatewayProbe){
    if(now-gatewayProbeAt<GATEWAY_PROBE_TIMEOUT)return true;
    waitingGatewayProbe=false;
  }
  if(qCount||waitingAck||now-lastGatewayProbe<GATEWAY_PROBE_INTERVAL)return false;
  MeshPacket probe{};probe.version=PROTOCOL_VERSION;probe.type=PACKET_GATEWAY_PROBE;
  copyText(probe.project_id,sizeof(probe.project_id),PROJECT_ID);copyText(probe.network_id,sizeof(probe.network_id),NETWORK_ID);
  copyText(probe.experiment_id,sizeof(probe.experiment_id),EXPERIMENT_ID);
  probe.source_id=NODE_ID;probe.destination_id=GATEWAY_ID;probe.next_hop_id=GATEWAY_ID;
  probe.forwarding_node_id=NODE_ID;probe.sequence=++gatewayProbeSequence;probe.source_uptime_ms=now;probe.hop_limit=MAX_HOPS;
  if(gatewayProbeAttempts<UINT16_MAX)++gatewayProbeAttempts;
  waitingGatewayProbe=true;gatewayProbeAt=lastGatewayProbe=now;
  if(!sendBroadcast(probe))gatewayProbeAt=now-GATEWAY_PROBE_TIMEOUT;
  return true;
}
static const char *routingModeName(uint8_t mode){
  return mode==ROUTING_ML_UPPER||mode==ROUTING_ML_LOWER?"ML_SELECTED":"BASELINE_FALLBACK";
}
static void sendAck(const uint8_t*mac,uint8_t previous,uint32_t seq,uint32_t uptime){
  MeshPacket a{};a.version=PROTOCOL_VERSION;a.type=PACKET_ACK;
  copyText(a.project_id,sizeof(a.project_id),PROJECT_ID);copyText(a.network_id,sizeof(a.network_id),NETWORK_ID);copyText(a.experiment_id,sizeof(a.experiment_id),EXPERIMENT_ID);
  a.source_id=NODE_ID;a.destination_id=previous;a.next_hop_id=previous;a.forwarding_node_id=NODE_ID;a.sequence=seq;a.source_uptime_ms=uptime;
  if(addPeer(mac))esp_now_send(mac,reinterpret_cast<const uint8_t*>(&a),sizeof(a));
}
static bool enqueue(const MeshPacket&p){if(qCount>=FORWARD_QUEUE_SIZE)return false;forwardQueue[qTail]=p;qTail=(qTail+1)%FORWARD_QUEUE_SIZE;++qCount;return true;}
static void processFrame(const RxFrame&f){
  const MeshPacket&p=f.packet;
  if(p.version!=PROTOCOL_VERSION||strncmp(p.project_id,PROJECT_ID,sizeof(p.project_id))||strncmp(p.network_id,NETWORK_ID,sizeof(p.network_id))||strncmp(p.experiment_id,EXPERIMENT_ID,sizeof(p.experiment_id)))return;
  if (isChannelSyncType(p.type)) { processChannelSyncFrame(f); return; }
  if (channelState != CHANNEL_STATE_SYNCED) return;
  requestStatusLED(LED_COLOR_GREEN,LED_SUCCESS_HOLD_MS);
  updateNeighbor(f.mac,f.rssi);
  if(p.type==PACKET_DELIVERY_REPORT&&p.source_id==GATEWAY_ID&&p.destination_id==1&&p.next_hop_id==1&&p.forwarding_node_id==NODE_ID){
    MeshPacket report=p;report.forwarding_node_id=NODE_ID;
    bool sent=sendBroadcast(report);
    Serial.printf("DELIVERY_REPORT_RELAY seq=%lu relay=%u tx=%s result=%s\n",(unsigned long)p.sequence,NODE_ID,sent?"queued":"failed",sent?"forwarded":"unconfirmed");
    return;
  }
  if(p.type==PACKET_GATEWAY_PROBE_ACK){
    if(waitingGatewayProbe&&p.source_id==GATEWAY_ID&&p.destination_id==NODE_ID&&p.sequence==gatewayProbeSequence&&p.source_uptime_ms==gatewayProbeAt){
      uint32_t rtt=millis()-gatewayProbeAt;waitingGatewayProbe=false;++gatewayProbeSuccesses;lastGatewaySuccess=millis();gatewayRssi=f.rssi;gatewayPathHops=p.hop_count;
      gatewayLatencyTotal+=rtt;gatewayLatencyMs=(uint16_t)min((uint32_t)UINT16_MAX,gatewayLatencyTotal/gatewayProbeSuccesses);
    }return;
  }
  if(p.type==PACKET_PATH_PROBE&&p.source_id==1&&p.destination_id==GATEWAY_ID){sendPathStatus(f);return;}
  if(p.type==PACKET_ACK){
    if(waitingAck&&p.source_id==GATEWAY_ID&&p.next_hop_id==NODE_ID&&p.sequence==inFlight.sequence&&p.source_uptime_ms==inFlight.source_uptime_ms){
      lastAckRtt=millis()-lastSend;++acked;++forwarded;qHead=(qHead+1)%FORWARD_QUEUE_SIZE;--qCount;waitingAck=false;txAttempts=0;
      requestStatusLED(LED_COLOR_GREEN,LED_SUCCESS_HOLD_MS);
      Serial.printf("FORWARD_ACK uptime=%lu source=1 relay=%u seq=%lu mode=%s result=forwarded ack=yes rtt_ms=%lu hop_count=%u\n",
        (unsigned long)millis(),NODE_ID,(unsigned long)p.sequence,
        inFlight.routing_algorithm==ROUTING_ML_UPPER||inFlight.routing_algorithm==ROUTING_ML_LOWER?"ML_ACTIVE":"BASELINE_FALLBACK",
        (unsigned long)lastAckRtt,inFlight.hop_count);
    }return;
  }
  if(p.type!=PACKET_DATA||p.next_hop_id!=NODE_ID||p.destination_id!=GATEWAY_ID||p.source_id==NODE_ID||p.hop_count>=p.hop_limit)return;
  if(!gatewayPathAvailable(millis())){requestStatusLED(LED_COLOR_RED,LED_ERROR_HOLD_MS);Serial.printf("DROP reason=gateway_path_unavailable seq=%lu\n",(unsigned long)p.sequence);return;}
  ++rxCount;
  if(seenBefore(p)){++duplicates;sendAck(f.mac,p.forwarding_node_id,p.sequence,p.source_uptime_ms);return;}
  if(qCount>=FORWARD_QUEUE_SIZE){requestStatusLED(LED_COLOR_RED,LED_ERROR_HOLD_MS);Serial.println("DROP reason=forward_queue_full");return;}
  MeshPacket forwardedPacket=p;forwardedPacket.last_hop_rssi_dbm=f.rssi;
  ++forwardedPacket.hop_count;forwardedPacket.forwarding_node_id=NODE_ID;forwardedPacket.next_hop_id=GATEWAY_ID;
  if(!enqueue(forwardedPacket))return;
  remember(p);sendAck(f.mac,p.forwarding_node_id,p.sequence,p.source_uptime_ms);
  Serial.printf("RECEIVED uptime=%lu current=%u source=%u selected_relay=%u seq=%lu mode=%s rssi=%d queued=yes\n",
    (unsigned long)millis(),NODE_ID,p.source_id,NODE_ID,(unsigned long)p.sequence,routingModeName(p.routing_algorithm),f.rssi);
}
static void serviceReceive(){RxFrame f{};while(xQueueReceive(rxQueue,&f,0)==pdTRUE)processFrame(f);}
static void serviceForward(){
  if(channelState!=CHANNEL_STATE_SYNCED||!qCount)return;
  if(!waitingAck){inFlight=forwardQueue[qHead];
    requestStatusLED(LED_COLOR_YELLOW,LED_ACTIVITY_HOLD_MS);
    txAttempts=1;++txCount;macSendFailed=false;
    if(sendBroadcast(inFlight)){lastSend=millis();waitingAck=true;
      Serial.printf("FORWARD_TX uptime=%lu current=%u source=%u seq=%lu source_relay=%u mode=%s tx=queued ack=pending hop_count=%u\n",
        (unsigned long)lastSend,NODE_ID,inFlight.source_id,(unsigned long)inFlight.sequence,NODE_ID,
        routingModeName(inFlight.routing_algorithm),inFlight.hop_count);
    }else{macSendFailed=true;lastSend=millis();waitingAck=true;
      Serial.printf("FORWARD_TX uptime=%lu current=%u source=%u seq=%lu mode=%s tx=local_error ack=pending hop_count=%u\n",
        (unsigned long)lastSend,NODE_ID,inFlight.source_id,(unsigned long)inFlight.sequence,routingModeName(inFlight.routing_algorithm),inFlight.hop_count);
    }return;
  }
  if(!macSendFailed&&millis()-lastSend<ACK_TIMEOUT_MS)return;
  if(txAttempts<MAX_TRANSMISSIONS){++txAttempts;++retries;macSendFailed=false;requestStatusLED(LED_COLOR_YELLOW,LED_ACTIVITY_HOLD_MS);
    if(sendBroadcast(inFlight)){lastSend=millis();}else{macSendFailed=true;lastSend=millis();}return;}
  ++failed;++txFailed;Serial.printf("FORWARD_FAILED uptime=%lu source=%u relay=%u seq=%lu mode=%s tx=failed ack=no attempts=%u hop_count=%u\n",
    (unsigned long)millis(),inFlight.source_id,NODE_ID,(unsigned long)inFlight.sequence,routingModeName(inFlight.routing_algorithm),txAttempts,inFlight.hop_count);
  requestStatusLED(LED_COLOR_RED,LED_ERROR_HOLD_MS);
  qHead=(qHead+1)%FORWARD_QUEUE_SIZE;--qCount;waitingAck=false;txAttempts=0;
}
void setup(){
  Serial.begin(115200);WiFi.mode(WIFI_STA);WiFi.setSleep(false);esp_wifi_set_channel(MESH_BOOT_CHANNEL,WIFI_SECOND_CHAN_NONE);configureChannelScanRange();
  pinMode(LED_RED,OUTPUT);pinMode(LED_YELLOW,OUTPUT);pinMode(LED_GREEN,OUTPUT);
  digitalWrite(LED_RED,LOW);digitalWrite(LED_YELLOW,LOW);digitalWrite(LED_GREEN,LOW);
  rxQueue=xQueueCreate(16,sizeof(RxFrame));if(!rxQueue){Serial.println("ERROR rx_queue");while(true)delay(1000);}
  if(esp_now_init()!=ESP_OK){Serial.println("ERROR esp_now_init");while(true)delay(1000);}
  addPeer(BROADCAST_MAC);esp_now_register_recv_cb(receiveCallback);
#if ESP_ARDUINO_VERSION_MAJOR >= 3
  esp_now_register_send_cb(sendCallback);
#else
  esp_now_register_send_cb(sendCallback);
#endif
  startChannelScan("boot");
  Serial.printf("READY ESP32_02 channel=%u mac=%s next_hop=%u mesh=discovering\n",meshChannel,WiFi.macAddress().c_str(),GATEWAY_ID);
}
void loop(){
  serviceChannelSync();
  serviceReceive();
  if(!serviceGatewayProbe())serviceForward();
  if(millis()-lastStats>=10000){lastStats=millis();uint8_t active=0;for(auto&n:neighbors)if(n.packets)++active;
    Serial.printf("LINK_STATS node=%u neighbors=%u rx=%lu forwarded=%lu acked=%lu duplicate=%lu retry=%lu failed=%lu loss_pct=%lu last_rssi=%d latency_ms=%lu\n",
      NODE_ID,active,(unsigned long)rxCount,(unsigned long)forwarded,(unsigned long)acked,(unsigned long)duplicates,(unsigned long)retries,(unsigned long)failed,
      (unsigned long)(txCount?min(100UL,txFailed*100UL/txCount):0),lastRssi,(unsigned long)lastAckRtt);
  }
  serviceStatusLED(channelState!=CHANNEL_STATE_SYNCED||!gatewayPathAvailable(millis()),qCount>0||waitingAck||waitingGatewayProbe);
  delay(1);
}
