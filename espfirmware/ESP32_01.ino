#include <array>
#include <cmath>

// Generated by ml/train_tree.py. Synthetic route scenario model; not hardware-trained.
namespace p12ganesh::ml {
inline constexpr const char *MODEL_VERSION = "decision-tree-v1-seed-20261101";
struct RouteFeatures {
    double upper_available, upper_pdr_estimate, upper_latency_ms, upper_hops;
    double lower_available, lower_pdr_estimate, lower_latency_ms, lower_hops;
};
inline std::array<double, 8> values(const RouteFeatures& f) {
    return {f.upper_available, f.upper_pdr_estimate, f.upper_latency_ms, f.upper_hops,
            f.lower_available, f.lower_pdr_estimate, f.lower_latency_ms, f.lower_hops};
}
inline constexpr int feature[21] = {1, 4, -2, 5, 5, -2, -2, -2, 2, 5, 5, -2, -2, 1, -2, -2, 5, 1, -2, -2, -2};
inline constexpr int left[21] = {1, 2, -1, 4, 5, -1, -1, -1, 9, 10, 11, -1, -1, 14, -1, -1, 17, 18, -1, -1, -1};
inline constexpr int right[21] = {8, 3, -1, 7, 6, -1, -1, -1, 16, 13, 12, -1, -1, 15, -1, -1, 20, 19, -1, -1, -1};
inline constexpr double threshold[21] = {0.907467335463, 0.5, -2, 0.865931242704, 0.859115302563, -2, -2, -2, 119.210910797, 0.995044529438, 0.962451845407, -2, -2, 0.984755635262, -2, -2, 0.919160217047, 0.980703085661, -2, -2, -2};
inline constexpr int leaf_label[21] = {1, 1, -1, 1, 1, 1, 1, 1, 0, 0, 0, 0, 0, 1, 1, 0, 1, 0, 1, 0, 1};
inline int predict(const RouteFeatures& input) {
    const auto x = values(input);
    for (double value : x) if (!std::isfinite(value)) return -2;
    int node = 0;
    while (left[node] != -1) node = (x[feature[node]] <= threshold[node]) ? left[node] : right[node];
    return leaf_label[node];
}
inline double expectedCost(double pdr, double latencyMs) {
    return pdr * latencyMs + (1.0 - pdr) * 1000.0;
}
inline bool usable(bool available, double pdr, double latencyMs, double hops) {
    return available && std::isfinite(pdr) && pdr >= 0 && pdr <= 1 &&
           std::isfinite(latencyMs) && latencyMs >= 0 && std::isfinite(hops) && hops >= 1;
}
inline int selectSafely(int prediction, const RouteFeatures& f) {
    const bool upper = usable(f.upper_available >= 0.5, f.upper_pdr_estimate, f.upper_latency_ms, f.upper_hops);
    const bool lower = usable(f.lower_available >= 0.5, f.lower_pdr_estimate, f.lower_latency_ms, f.lower_hops);
    if (prediction == 0 && upper) return 0;
    if (prediction == 1 && lower) return 1;
    if (!upper && !lower) return -1;
    if (!upper) return 1;
    if (!lower) return 0;
    const double upperCost = expectedCost(f.upper_pdr_estimate, f.upper_latency_ms);
    const double lowerCost = expectedCost(f.lower_pdr_estimate, f.lower_latency_ms);
    if (upperCost != lowerCost) return upperCost < lowerCost ? 0 : 1;
    return f.upper_hops <= f.lower_hops ? 0 : 1;
}
} // namespace p12ganesh::ml

// P12-IOT ESP32_01 — sensor/source node. Cloud HTTPS runs on ESP32_04.
#include <Arduino.h>
#include <WiFi.h>
#include <esp_now.h>
#include <esp_wifi.h>
#include <esp_arduino_version.h>
#include <freertos/FreeRTOS.h>
#include <freertos/queue.h>
#include <Wire.h>
#include <DHT.h>
#include <Adafruit_GFX.h>
#include <Adafruit_SH110X.h>
#include <math.h>
#include <string.h>
#include <limits.h>
#include <Preferences.h>

static constexpr char PROJECT_ID[] = "P12-IOT";
static constexpr char NETWORK_ID[] = "P12-MESH-01";
static constexpr char EXPERIMENT_ID[] = "EXP-003";
static constexpr char FIRMWARE_VERSION[] = "4.0.0";
static constexpr uint8_t PROTOCOL_VERSION = 2;
#define NODE_ID 1
static constexpr uint8_t PACKET_DATA = 1;
static constexpr uint8_t PACKET_ACK = 2;
static constexpr uint8_t PACKET_PATH_PROBE = 3;
static constexpr uint8_t PACKET_PATH_STATUS = 4;
static constexpr uint8_t PACKET_DELIVERY_REPORT = 7;
static constexpr uint8_t PACKET_GATEWAY_BEACON = 8;
static constexpr uint8_t PACKET_CHANNEL_SYNC_REQUEST = 9;
static constexpr uint8_t PACKET_CHANNEL_SYNC_RESPONSE = 10;
static constexpr uint8_t PACKET_CHANNEL_SYNC_ACK = 11;
static constexpr uint8_t PACKET_CHANNEL_CHANGE_NOTICE = 12;
static constexpr uint32_t ROUTING_CONTROL_MAGIC = 0x50315243UL;
static constexpr uint8_t ROUTING_CONTROL_VERSION = 1;
static constexpr uint8_t ROUTING_CONTROL_STATE = 1;
static constexpr uint8_t ROUTING_CONTROL_COMMAND = 2;
static constexpr uint8_t ROUTING_CONTROL_RESULT = 3;
static constexpr uint8_t ROUTING_RESULT_APPLIED = 1;
static constexpr uint8_t ROUTING_RESULT_NO_CHANGE = 2;
static constexpr uint8_t ROUTING_RESULT_REJECTED = 3;
static constexpr uint8_t ROUTING_RESULT_EXPIRED = 4;
static constexpr uint32_t ROUTING_COMMAND_MAX_TTL_MS = 60000UL;
static constexpr uint8_t SYNC_MARKER = 0xD2;
static constexpr uint8_t SYNC_ROUTE_MARKER = 0xC3;
static constexpr uint32_t SYNC_MAGIC = 0x50313243UL;
static constexpr uint32_t CHANNEL_BEACON_INTERVAL_MS = 250UL;
static constexpr uint32_t CHANNEL_SCAN_DWELL_MS = 350UL;
static constexpr uint32_t CHANNEL_SCAN_PAUSE_MS = 250UL;
static constexpr uint32_t CHANNEL_BEACON_TIMEOUT_MS = 1800UL;
static constexpr uint32_t CHANNEL_SYNC_RETRY_MS = 700UL;
static constexpr uint8_t CHANNEL_SYNC_MAX_RETRIES = 4;
static constexpr uint8_t CHANNEL_STATE_SCAN = 0;
static constexpr uint8_t CHANNEL_STATE_WAIT = 1;
static constexpr uint8_t CHANNEL_STATE_SYNCED = 2;
static uint8_t meshChannel = 1, channelState = CHANNEL_STATE_SCAN;
static uint8_t scanFirstChannel = 1, scanLastChannel = 11, scanChannel = 1, syncRetries = 0;
static bool scanCountryAvailable = false;
static uint32_t scanDwellAt = 0, scanPauseAt = 0, lastGatewayBeaconAt = 0;
static uint32_t syncSequence = 0, syncRequestAt = 0, syncNonceUptime = 0, lastSyncAckAt = 0;
static uint8_t gatewayMac[6]{};

static constexpr uint8_t ROUTING_BASELINE_FALLBACK = 1;
static constexpr uint8_t ROUTING_ML_UPPER = 2;
static constexpr uint8_t ROUTING_ML_LOWER = 3;
static constexpr uint8_t ROUTING_NO_VALID_ROUTE = 4;
static constexpr int MODEL_INVALID = -2;
static constexpr int MODEL_UNAVAILABLE = -99;
#ifndef P12_FORCE_BASELINE
#define P12_FORCE_BASELINE 0
#endif
static constexpr uint8_t GATEWAY_ID = 4;
static constexpr uint8_t MESH_BOOT_CHANNEL = 1;
static constexpr uint8_t MAX_HOPS = 4;
static constexpr uint8_t LIGHT_UNKNOWN = 255;
static constexpr int16_t UNKNOWN_I16 = INT16_MIN;
static constexpr uint16_t UNKNOWN_U16 = UINT16_MAX;
static constexpr uint32_t UNKNOWN_U32 = UINT32_MAX;

struct __attribute__((packed)) MeshPacket {
  uint8_t version;
  uint8_t type;
  char project_id[8];
  char network_id[12];
  char experiment_id[8];
  uint8_t source_id;
  uint8_t destination_id;
  uint8_t next_hop_id;
  uint8_t forwarding_node_id;
  uint8_t routing_algorithm;
  uint32_t sequence;
  uint32_t source_uptime_ms;
  uint8_t hop_count;
  uint8_t hop_limit;
  int16_t temperature_centi_c;
  uint16_t humidity_centi_percent;
  uint8_t light_status;
  uint8_t sound_detected;
  int16_t last_hop_rssi_dbm;
  uint16_t latency_ms;
  uint8_t packet_loss_percent;
  uint32_t throughput_bps;
  uint8_t feature_valid;
  int8_t predicted_class;
  uint8_t route_change;
  uint8_t route_change_reason;
  uint8_t selected_next_hop_id;
  uint32_t source_packets_sent;
  float model_features[8];
};
static_assert(sizeof(MeshPacket) <= 250, "ESP-NOW payload too large");
struct __attribute__((packed)) RoutingControlFrame {
  uint32_t magic;
  uint8_t version, kind, source_id, destination_id, enabled, result;
  uint32_t epoch, command_sequence, ttl_ms, evidence_sequence;
  uint8_t expected_next_hop, requested_next_hop;
};
static_assert(sizeof(RoutingControlFrame) <= 250, "ESP-NOW control payload too large");
struct RxFrame { uint8_t mac[6]; MeshPacket packet; int16_t rssi; };
struct RoutingControlRx { uint8_t mac[6]; RoutingControlFrame frame; uint32_t received_at_ms; };
struct CandidatePath {
  uint16_t attempts = 0, responses = 0;
  uint32_t windowStarted = 0, lastStatusMs = 0, lastStatusSequence = 0;
  uint32_t sourceRttTotalMs = 0;
  uint16_t gatewayLatencyMs = UNKNOWN_U16;
  uint8_t gatewayLossPercent = 255;
  uint8_t pathHops = 0;
  bool gatewayAvailable = false, gatewayAvailabilityKnown = false;
};
struct RouteDecision {
  uint8_t nextHop = 0, mode = ROUTING_BASELINE_FALLBACK;
  int prediction = MODEL_UNAVAILABLE;
  bool featuresValid = false;
  p12ganesh::ml::RouteFeatures features{};
  const char *reason = "metric_window_warming";
};
enum DeliveryState : uint8_t { DELIVERY_NONE, DELIVERY_PENDING, DELIVERY_CONFIRMED, DELIVERY_UNCONFIRMED };


static bool isChannelSyncType(uint8_t type);
static bool validChannelSyncPacket(const MeshPacket &p);
static MeshPacket makeChannelSyncPacket(uint8_t type, uint8_t source, uint8_t destination,
                                       uint8_t channel, uint32_t sequence, uint32_t uptime);
static bool sendChannelSyncPacket(const uint8_t *mac, const MeshPacket &p);
static void configureChannelScanRange();
static void startChannelScan(const char *reason);
static void serviceChannelSync();
static bool processChannelSyncFrame(const RxFrame &frame);

static bool addPeer(const uint8_t *mac);
// Keep all declarations after custom types: Arduino may inject prototypes before definitions.
static bool sendBroadcast(const MeshPacket &packet);
static void copyText(char *dst, size_t size, const char *src);
static CandidatePath &candidateFor(uint8_t node);
static void resetProbeWindowIfNeeded(CandidatePath &c, uint32_t now);
static bool pathStatusFresh(const CandidatePath &c, uint32_t now);
static const char *candidateState(const CandidatePath &c, uint32_t now);
static const char *shortRouteReason(const char *reason);
static bool routeFeaturesValid(uint32_t now, p12ganesh::ml::RouteFeatures &f);
static bool candidateMetricsAvailable(const CandidatePath &c, uint32_t now, double &pdr, double &latencyMs);
static bool bothRoutesKnownDown(uint32_t now);
static void recordPathStatus(const RxFrame &frame);
static bool servicePathProbe();
static RouteDecision selectRoute();
void setLED(bool red, bool yellow, bool green);
static void serviceStatusLED(bool processingActive);
void readSensors();
#if ESP_ARDUINO_VERSION_MAJOR >= 3
static void receiveCallback(const esp_now_recv_info_t *info, const uint8_t *data, int len);
static void sendCallback(const wifi_tx_info_t *, esp_now_send_status_t status);
#else
static void receiveCallback(const uint8_t *mac, const uint8_t *data, int len);
static void sendCallbackLegacy(const uint8_t *, esp_now_send_status_t status);
#endif
static bool sendPacket();
static void makePacket(const RouteDecision &decision);
static void handleAcks();
static void serviceRoutingControl();
static void sendRoutingControlResult(const RoutingControlRx &rx, uint8_t result);
static void processRoutingControl(const RoutingControlRx &rx);
static void serviceMesh();
static void drawScreen();
void setup();
void loop();

static constexpr uint8_t BROADCAST_MAC[6] = {0xFF,0xFF,0xFF,0xFF,0xFF,0xFF};
static bool addPeer(const uint8_t *mac) {
  if (esp_now_is_peer_exist(mac)) return true;
  esp_now_peer_info_t peer{};
  memcpy(peer.peer_addr, mac, 6);
  peer.channel = 0;
  peer.ifidx = WIFI_IF_STA;
  peer.encrypt = false;
  return esp_now_add_peer(&peer) == ESP_OK;
}
static bool sendBroadcast(const MeshPacket &packet) {
  return esp_now_send(BROADCAST_MAC, reinterpret_cast<const uint8_t *>(&packet), sizeof(packet)) == ESP_OK;
}
static void copyText(char *dst, size_t size, const char *src) {
  strncpy(dst, src, size - 1);
  dst[size - 1] = '\0';
}

static bool isChannelSyncType(uint8_t type) {
  return type >= PACKET_GATEWAY_BEACON && type <= PACKET_CHANNEL_CHANGE_NOTICE;
}
static bool validChannelSyncPacket(const MeshPacket &p) {
  return p.version == PROTOCOL_VERSION && isChannelSyncType(p.type) &&
    !strncmp(p.project_id, PROJECT_ID, sizeof(p.project_id)) &&
    !strncmp(p.network_id, NETWORK_ID, sizeof(p.network_id)) &&
    !strncmp(p.experiment_id, EXPERIMENT_ID, sizeof(p.experiment_id)) &&
    p.routing_algorithm == SYNC_MARKER && p.feature_valid == 0xA5 &&
    p.predicted_class == -42 && p.route_change == SYNC_ROUTE_MARKER &&
    p.route_change_reason == 0x51 && p.hop_count == 0x5A && p.hop_limit == 0xA5 &&
    p.source_packets_sent == SYNC_MAGIC && p.next_hop_id >= 1 && p.next_hop_id <= 13 &&
    p.selected_next_hop_id == p.next_hop_id;
}
static MeshPacket makeChannelSyncPacket(uint8_t type, uint8_t source, uint8_t destination,
                                        uint8_t channel, uint32_t sequence, uint32_t uptime) {
  MeshPacket p{}; p.version=PROTOCOL_VERSION; p.type=type;
  copyText(p.project_id,sizeof(p.project_id),PROJECT_ID);
  copyText(p.network_id,sizeof(p.network_id),NETWORK_ID);
  copyText(p.experiment_id,sizeof(p.experiment_id),EXPERIMENT_ID);
  p.source_id=source; p.destination_id=destination; p.next_hop_id=channel;
  p.selected_next_hop_id=channel; p.routing_algorithm=SYNC_MARKER; p.sequence=sequence;
  p.source_uptime_ms=uptime; p.hop_count=0x5A; p.hop_limit=0xA5;
  p.feature_valid=0xA5; p.predicted_class=-42; p.route_change=SYNC_ROUTE_MARKER;
  p.route_change_reason=0x51; p.source_packets_sent=SYNC_MAGIC; return p;
}
static bool sendChannelSyncPacket(const uint8_t *mac, const MeshPacket &p) {
  return addPeer(mac) && esp_now_send(mac,reinterpret_cast<const uint8_t*>(&p),sizeof(p))==ESP_OK;
}
static void configureChannelScanRange() {
  wifi_country_t country{};
  scanCountryAvailable=esp_wifi_get_country(&country)==ESP_OK&&country.nchan;
  if (scanCountryAvailable) {
    scanFirstChannel=country.schan;
    scanLastChannel=(uint8_t)min(13,(int)country.schan+(int)country.nchan-1);
  } else { scanFirstChannel=1; scanLastChannel=11; }
  if (scanFirstChannel<1 || scanFirstChannel>13 || scanFirstChannel>scanLastChannel) {
    scanFirstChannel=1; scanLastChannel=11;
  }
  scanChannel=scanFirstChannel;
  Serial.printf("CHANNEL_SCAN_RANGE first=%u last=%u regulatory_source=%s\n",scanFirstChannel,scanLastChannel,scanCountryAvailable?"configured":"world_safe_fallback");
}
static void startChannelScan(const char *reason) {
  meshChannel=scanChannel; channelState=CHANNEL_STATE_SCAN; syncRetries=0;
  scanDwellAt=0; scanPauseAt=millis(); lastGatewayBeaconAt=0;
  Serial.printf("MESH_DISCOVERY_START node=%u channel=%u reason=%s\n",NODE_ID,meshChannel,reason);
}
static bool processChannelSyncFrame(const RxFrame &frame) {
  const MeshPacket &p=frame.packet;
  if (!isChannelSyncType(p.type)) return false;
  if (!validChannelSyncPacket(p) || p.source_id!=GATEWAY_ID ||
      (p.destination_id!=NODE_ID && p.destination_id!=255)) return true;
  uint8_t radioChannel=0; wifi_second_chan_t second;
  if (esp_wifi_get_channel(&radioChannel,&second)!=ESP_OK || radioChannel!=p.next_hop_id) return true;
  if (p.type==PACKET_GATEWAY_BEACON || p.type==PACKET_CHANNEL_CHANGE_NOTICE) {
    lastGatewayBeaconAt=millis();
    if (channelState==CHANNEL_STATE_SYNCED) return true;
    if (channelState==CHANNEL_STATE_SCAN) {
      memcpy(gatewayMac,frame.mac,sizeof(gatewayMac)); meshChannel=p.next_hop_id;
      channelState=CHANNEL_STATE_WAIT; syncRetries=0; syncRequestAt=0;
      Serial.printf("CHANNEL_BEACON_FOUND node=%u channel=%u\n",NODE_ID,meshChannel);
    }
    return true;
  }
  if (p.type==PACKET_CHANNEL_SYNC_RESPONSE && p.destination_id==NODE_ID &&
      channelState==CHANNEL_STATE_WAIT && p.sequence==syncSequence && p.source_uptime_ms==syncNonceUptime &&
      memcmp(frame.mac,gatewayMac,sizeof(gatewayMac))==0) {
    channelState=CHANNEL_STATE_SYNCED; meshChannel=p.next_hop_id;
    lastGatewayBeaconAt=millis(); syncRetries=0; lastSyncAckAt=millis();
    MeshPacket ack=makeChannelSyncPacket(PACKET_CHANNEL_SYNC_ACK,NODE_ID,GATEWAY_ID,meshChannel,syncSequence,syncNonceUptime);
    sendChannelSyncPacket(gatewayMac,ack);
    Serial.printf("NODE_CHANNEL_SYNC node=%u channel=%u result=success\n",NODE_ID,meshChannel);
    return true;
  }
  return true;
}
static void serviceChannelSync() {
  uint32_t now=millis();
  if (channelState==CHANNEL_STATE_SYNCED && now-lastGatewayBeaconAt>CHANNEL_BEACON_TIMEOUT_MS) {
    Serial.printf("CHANNEL_SYNC_LOST node=%u channel=%u age_ms=%lu reason=beacon_timeout\n",NODE_ID,meshChannel,(unsigned long)(now-lastGatewayBeaconAt));
    startChannelScan("gateway_beacon_timeout");
  }
  if (channelState==CHANNEL_STATE_SYNCED) {
    if (now-lastSyncAckAt>=5000UL) {
      MeshPacket ack=makeChannelSyncPacket(PACKET_CHANNEL_SYNC_ACK,NODE_ID,GATEWAY_ID,meshChannel,syncSequence,syncNonceUptime);
      if (sendChannelSyncPacket(gatewayMac,ack)) lastSyncAckAt=now;
    }
    return;
  }
  if (channelState==CHANNEL_STATE_WAIT) {
    if (now-syncRequestAt>=CHANNEL_SYNC_RETRY_MS) {
      if (syncRetries>=CHANNEL_SYNC_MAX_RETRIES) {
        Serial.printf("CHANNEL_SYNC_FAILED node=%u channel=%u retries=%u reason=response_timeout\n",NODE_ID,meshChannel,syncRetries);
        channelState=CHANNEL_STATE_SCAN; scanDwellAt=now; scanChannel=(meshChannel>=scanLastChannel)?scanFirstChannel:(uint8_t)(meshChannel+1);
        scanPauseAt=now+CHANNEL_SCAN_PAUSE_MS; return;
      }
      ++syncRetries; ++syncSequence; syncNonceUptime=now;
      MeshPacket request=makeChannelSyncPacket(PACKET_CHANNEL_SYNC_REQUEST,NODE_ID,GATEWAY_ID,meshChannel,syncSequence,syncNonceUptime);
      if (!sendChannelSyncPacket(gatewayMac,request)) Serial.printf("CHANNEL_SYNC_RETRY node=%u channel=%u retry=%u reason=send_failed\n",NODE_ID,meshChannel,syncRetries);
      syncRequestAt=now;
    }
    return;
  }
  if (now<scanPauseAt) return;
  if (!scanDwellAt || now-scanDwellAt>=CHANNEL_SCAN_DWELL_MS) {
    uint8_t attempts=0; esp_err_t err=ESP_FAIL;
    while (attempts++<=scanLastChannel-scanFirstChannel) {
      err=esp_wifi_set_channel(scanChannel,WIFI_SECOND_CHAN_NONE);
      if (err==ESP_OK) break;
      scanChannel=(scanChannel>=scanLastChannel)?scanFirstChannel:(uint8_t)(scanChannel+1);
    }
    if (err!=ESP_OK) { Serial.printf("CHANNEL_SCAN_BLOCKED node=%u reason=no_permitted_channels\n",NODE_ID); scanPauseAt=now+1000UL; return; }
    meshChannel=scanChannel; scanDwellAt=now;
    Serial.printf("CHANNEL_SCAN node=%u channel=%u\n",NODE_ID,meshChannel);
    if(scanChannel>=scanLastChannel){
      scanChannel=scanFirstChannel;scanPauseAt=now+CHANNEL_SCAN_PAUSE_MS;
      Serial.printf("CHANNEL_SCAN_CYCLE_COMPLETE node=%u next_scan_after_ms=%lu\n",NODE_ID,(unsigned long)CHANNEL_SCAN_PAUSE_MS);
    }else scanChannel=(uint8_t)(scanChannel+1);
  }
}


#define NODE_NAME "ESP32_01"
#define LDR_ACTIVE LOW
#define SOUND_ACTIVE LOW
#define DHT_PIN 17
#define LDR_PIN 18
#define SOUND_PIN 19
#define OLED_SDA 15
#define OLED_SCL 16
#define LED_RED 21
#define LED_YELLOW 22
#define LED_GREEN 23
#define LED_SUCCESS_HOLD_MS 700UL
#define LED_ACTIVITY_HOLD_MS 250UL
#define LED_ERROR_HOLD_MS 900UL
#define DHT_TYPE DHT11
#define OLED_ADDRESS 0x3C
#define SENSOR_INTERVAL 2000UL
#define SEND_INTERVAL 2000UL
#define PATH_PROBE_INTERVAL 1000UL
#define PATH_PROBE_WINDOW 30000UL
#define PATH_STATUS_MAX_AGE 5000UL
#define PATH_MIN_SAMPLES 5
#define DELIVERY_REPORT_TIMEOUT 2500UL
#define ACK_TIMEOUT 350UL
#define MAX_TRANSMISSIONS 4

static DHT dht(DHT_PIN, DHT_TYPE);
static Adafruit_SH1106G display(128, 64, &Wire, -1);
static QueueHandle_t rxQueue;
static QueueHandle_t routingControlQueue;
static Preferences routingPrefs;
static bool pythonOwnsRoute = false;
static uint32_t routingControlEpoch = 0, lastPythonCommandSequence = 0;
static uint8_t lastPythonCommandResult = ROUTING_RESULT_REJECTED;
static uint32_t lastOwnershipFrameAt = 0, ownershipLeaseMs = 0;
static MeshPacket currentPacket{};
static volatile bool macSendFailed = false;
static bool dhtValid = false, lightStatus = false, soundStatus = false;
static float temperature = NAN, humidity = NAN;
static uint32_t lastSensorRead = 0, lastSend = 0, lastScreen = 0, lastRotation = 0;
static uint32_t sequenceNumber = 1, sentPackets = 0, ackedPackets = 0, failedPackets = 0, retryPackets = 0;
static uint32_t lastAckRtt = 0;
static int16_t lastAckRssi = UNKNOWN_I16;
static uint8_t transmissions = 0, screen = 0;
static bool waitingForAck = false, oledReady = false, espNowReady = false;
static CandidatePath candidates[2]{};
static RouteDecision currentDecision{};
static uint32_t pathProbeSequence = 0, lastPathProbe = 0, lastRouteChange = 0;
static uint32_t lastAckAt = 0;
static uint32_t lastCommunicationAt = 0;
static uint8_t selectedRelay = 2, lastAckRelay = 0;
static bool lastAckSucceeded = false, hasTxResult = false;
static const char *lastRouteChangeReason = "startup";
static DeliveryState deliveryState = DELIVERY_NONE;
static uint32_t pendingDeliverySequence = 0, pendingDeliveryUptime = 0, deliveryStartedAt = 0;
static uint8_t deliveredViaRelay = 0;
static uint32_t throughputWindowStart = 0, deliveredCount = 0, lastCountedDeliverySequence = 0;
static uint64_t deliveredBits = 0;
static uint32_t measuredThroughputBps = UNKNOWN_U32;
static uint32_t ledRedUntil = 0, ledYellowUntil = 0, ledGreenUntil = 0;
static bool ledRedOn = false, ledYellowOn = false, ledGreenOn = false;

static CandidatePath &candidateFor(uint8_t node) { return candidates[node == 2 ? 0 : 1]; }
static void resetProbeWindowIfNeeded(CandidatePath &c, uint32_t now) {
  if (!c.windowStarted || now - c.windowStarted >= PATH_PROBE_WINDOW) {
    c.attempts = c.responses = 0; c.sourceRttTotalMs = 0; c.windowStarted = now;
  }
}
static bool pathStatusFresh(const CandidatePath &c, uint32_t now) {
  return c.lastStatusMs && now - c.lastStatusMs <= PATH_STATUS_MAX_AGE &&
         c.gatewayLatencyMs != UNKNOWN_U16 && c.gatewayLossPercent <= 100;
}
static const char *candidateState(const CandidatePath &c, uint32_t now) {
  if (!c.lastStatusMs || now-c.lastStatusMs>PATH_STATUS_MAX_AGE || !c.gatewayAvailabilityKnown) return "UNKNOWN";
  return c.gatewayAvailable ? "UP" : "DOWN";
}
static const char *shortRouteReason(const char *reason) {
  if (!strcmp(reason, "required_candidate_metrics_missing_or_stale")) return "metrics missing";
  if (!strcmp(reason, "model_class_upper")) return "model upper";
  if (!strcmp(reason, "model_class_lower")) return "model lower";
  if (!strcmp(reason, "invalid_model_class")) return "invalid model";
  if (!strcmp(reason, "model_route_improved")) return "model improved";
  if (!strcmp(reason, "model_selected_route")) return "model selection";
  if (!strcmp(reason, "both_paths_unavailable")) return "both paths down";
  if (!strcmp(reason, "model_no_usable_route")) return "model no route";
  if (!strcmp(reason, "model_predicted_unavailable_candidate")) return "safe fallback";
  if (!strcmp(reason, "baseline_experiment_override")) return "baseline mode";
  if (!strcmp(reason, "metric_window_warming")) return "probing";
  if (!strcmp(reason, "safe_selector_no_route")) return "no safe route";
  if (!strcmp(reason, "invalid_prediction_no_safe_candidate")) return "bad prediction";
  return reason;
}
static bool routeFeaturesValid(uint32_t now, p12ganesh::ml::RouteFeatures &f) {
  for (uint8_t i = 0; i < 2; ++i) {
    const CandidatePath &c = candidates[i];
    if (c.attempts < PATH_MIN_SAMPLES || c.responses == 0 || c.responses > c.attempts || !c.gatewayAvailabilityKnown ||
        !pathStatusFresh(c, now) || c.gatewayLossPercent > 100 ||
        c.gatewayLatencyMs == UNKNOWN_U16 || c.pathHops == 0) return false;
  }
  const double pdr2 = (double)candidates[0].responses / candidates[0].attempts *
                      (100.0 - candidates[0].gatewayLossPercent) / 100.0;
  const double pdr3 = (double)candidates[1].responses / candidates[1].attempts *
                      (100.0 - candidates[1].gatewayLossPercent) / 100.0;
  // Model expects path delay; probes measure request/ACK RTT, so estimate one-way delay as RTT/2 per link.
  const double latency2 = ((double)candidates[0].sourceRttTotalMs / candidates[0].responses + candidates[0].gatewayLatencyMs) / 2.0;
  const double latency3 = ((double)candidates[1].sourceRttTotalMs / candidates[1].responses + candidates[1].gatewayLatencyMs) / 2.0;
  f = {candidates[0].gatewayAvailable ? 1.0 : 0.0, pdr2, latency2, (double)candidates[0].pathHops,
       candidates[1].gatewayAvailable ? 1.0 : 0.0, pdr3, latency3, (double)candidates[1].pathHops};
  const auto x = p12ganesh::ml::values(f);
  for (double value : x) if (!std::isfinite(value)) return false;
  return pdr2 >= 0 && pdr2 <= 1 && pdr3 >= 0 && pdr3 <= 1 && latency2 >= 0 && latency3 >= 0;
}
static bool candidateMetricsAvailable(const CandidatePath &c, uint32_t now, double &pdr, double &latencyMs) {
  if (c.attempts < PATH_MIN_SAMPLES || c.responses == 0 || !pathStatusFresh(c, now) ||
      !c.gatewayAvailable || c.pathHops == 0) return false;
  pdr = ((double)c.responses / c.attempts) * ((100.0 - c.gatewayLossPercent) / 100.0);
  latencyMs = ((double)c.sourceRttTotalMs / c.responses + c.gatewayLatencyMs) / 2.0;
  return std::isfinite(pdr) && pdr >= 0.0 && pdr <= 1.0 && std::isfinite(latencyMs) && latencyMs >= 0.0;
}
static bool bothRoutesKnownDown(uint32_t now) {
  for (const CandidatePath &c : candidates) {
    if (c.attempts < PATH_MIN_SAMPLES) return false;
    bool sourceUnavailable = c.responses == 0;
    bool gatewayUnavailable = c.responses >= PATH_MIN_SAMPLES && c.lastStatusMs &&
      now-c.lastStatusMs<=PATH_STATUS_MAX_AGE && c.gatewayLossPercent<=100 && !c.gatewayAvailable;
    if (!sourceUnavailable && !gatewayUnavailable) return false;
  }
  return true;
}
static void recordPathStatus(const RxFrame &frame) {
  const MeshPacket &p = frame.packet;
  if (p.version != PROTOCOL_VERSION || strncmp(p.project_id,PROJECT_ID,sizeof(p.project_id)) ||
      strncmp(p.network_id,NETWORK_ID,sizeof(p.network_id)) ||
      strncmp(p.experiment_id,EXPERIMENT_ID,sizeof(p.experiment_id)) ||
      p.source_id < 2 || p.source_id > 3 || p.destination_id != NODE_ID ||
      p.sequence != pathProbeSequence || p.type != PACKET_PATH_STATUS) return;
  // PATH_STATUS: 1=up, 0=measured down, 255=unknown; never treat unknown as down.
  if ((p.feature_valid > 1 && p.feature_valid != 255) || p.hop_count > MAX_HOPS) return;
  CandidatePath &c = candidateFor(p.source_id);
  if (c.lastStatusSequence == p.sequence) return;
  c.lastStatusSequence = p.sequence;
  c.lastStatusMs = millis();
  lastCommunicationAt = c.lastStatusMs;
  if (c.responses < UINT16_MAX) ++c.responses;
  c.sourceRttTotalMs += (uint32_t)(millis() - p.source_uptime_ms);
  c.gatewayLatencyMs = p.latency_ms;
  c.gatewayLossPercent = p.packet_loss_percent;
  c.gatewayAvailable = p.feature_valid == 1;
  c.gatewayAvailabilityKnown = p.feature_valid <= 1;
  c.pathHops = p.hop_count;
}
static bool servicePathProbe() {
  uint32_t now = millis();
  if (waitingForAck || now - lastPathProbe < PATH_PROBE_INTERVAL) return false;
  for (CandidatePath &c : candidates) { resetProbeWindowIfNeeded(c, now); if (c.attempts < UINT16_MAX) ++c.attempts; }
  MeshPacket p{}; p.version = PROTOCOL_VERSION; p.type = PACKET_PATH_PROBE;
  copyText(p.project_id, sizeof(p.project_id), PROJECT_ID); copyText(p.network_id, sizeof(p.network_id), NETWORK_ID);
  copyText(p.experiment_id, sizeof(p.experiment_id), EXPERIMENT_ID);
  p.source_id = NODE_ID; p.destination_id = GATEWAY_ID; p.forwarding_node_id = NODE_ID;
  p.sequence = ++pathProbeSequence; p.source_uptime_ms = now; p.hop_limit = MAX_HOPS;
  bool sent = sendBroadcast(p); lastPathProbe = now;
  Serial.printf("PATH_PROBE seq=%lu tx=%s\n", (unsigned long)p.sequence, sent ? "ok" : "failed");
  return true;
}
static RouteDecision selectRoute() {
  RouteDecision d{}; uint32_t now = millis();
  d.featuresValid = routeFeaturesValid(now, d.features);
  if (pythonOwnsRoute) {
    if (selectedRelay==2 || selectedRelay==3) {
      const CandidatePath &active=candidateFor(selectedRelay);
      if (active.gatewayAvailabilityKnown && active.gatewayAvailable && pathStatusFresh(active,now) &&
          active.attempts>=PATH_MIN_SAMPLES && active.responses>0 && active.pathHops>0 && active.pathHops<MAX_HOPS) {
        d.nextHop=selectedRelay; d.mode=selectedRelay==2?ROUTING_ML_UPPER:ROUTING_ML_LOWER;
        d.reason="python_route_ownership"; return d;
      }
    }
    d.mode=ROUTING_NO_VALID_ROUTE; d.reason="python_owned_route_unavailable"; return d;
  }
  if (bothRoutesKnownDown(now)) { d.mode = ROUTING_NO_VALID_ROUTE; d.reason = "both_paths_unavailable"; return d; }
  if (d.featuresValid && !P12_FORCE_BASELINE) {
    d.prediction = p12ganesh::ml::predict(d.features);
    const int safeSelection = p12ganesh::ml::selectSafely(d.prediction, d.features);
    if (safeSelection >= 0) {
      d.nextHop = safeSelection == 0 ? 2 : 3;
      if (d.prediction == safeSelection) {
        d.mode = d.prediction == 0 ? ROUTING_ML_UPPER : ROUTING_ML_LOWER;
        d.reason = d.prediction == 0 ? "model_class_upper" : "model_class_lower";
      } else {
        d.mode = ROUTING_BASELINE_FALLBACK;
        d.reason = "model_predicted_unavailable_candidate";
      }
      return d;
    }
    d.mode = ROUTING_NO_VALID_ROUTE;
    d.reason = d.prediction == -1 ? "model_no_usable_route" : "invalid_prediction_no_safe_candidate";
    return d;
  } else if (d.featuresValid) d.reason = "baseline_experiment_override";
  else d.reason = "required_candidate_metrics_missing_or_stale";

  d.mode = ROUTING_BASELINE_FALLBACK;
  if (candidates[0].lastStatusMs && now-candidates[0].lastStatusMs<=PATH_STATUS_MAX_AGE &&
      candidates[0].gatewayAvailabilityKnown && candidates[0].gatewayAvailable) d.nextHop = 2;
  else if (candidates[1].lastStatusMs && now-candidates[1].lastStatusMs<=PATH_STATUS_MAX_AGE &&
           candidates[1].gatewayAvailabilityKnown && candidates[1].gatewayAvailable) d.nextHop = 3;
  else {
    d.mode = ROUTING_NO_VALID_ROUTE;
    d.reason = bothRoutesKnownDown(now) ? "both_paths_unavailable" : "required_candidate_metrics_missing_or_stale";
  }
  return d;
}

void setLED(bool red, bool yellow, bool green) {
  uint32_t now = millis();
  if (red) ledRedUntil = now + LED_ERROR_HOLD_MS;
  if (yellow) ledYellowUntil = now + LED_ACTIVITY_HOLD_MS;
  if (green) ledGreenUntil = now + LED_SUCCESS_HOLD_MS;
  if (!red && !yellow && !green) ledRedUntil = ledYellowUntil = ledGreenUntil = now;
}
static void serviceStatusLED(bool processingActive) {
  uint32_t now = millis();
  bool errorActive = currentDecision.mode == ROUTING_NO_VALID_ROUTE || deliveryState == DELIVERY_UNCONFIRMED;
  bool red = errorActive || (int32_t)(ledRedUntil - now) > 0;
  bool yellow = !red && (processingActive || (int32_t)(ledYellowUntil - now) > 0);
  bool green = !red && !yellow && (int32_t)(ledGreenUntil - now) > 0;
  if (red != ledRedOn) digitalWrite(LED_RED, red ? HIGH : LOW);
  if (yellow != ledYellowOn) digitalWrite(LED_YELLOW, yellow ? HIGH : LOW);
  if (green != ledGreenOn) digitalWrite(LED_GREEN, green ? HIGH : LOW);
  ledRedOn = red; ledYellowOn = yellow; ledGreenOn = green;
}

// Preserved original working sensor implementation exactly.
void readSensors() {

  if (millis() - lastSensorRead >= 2000) {

    lastSensorRead = millis();

    float t = dht.readTemperature();
    float h = dht.readHumidity();

    dhtValid = !isnan(t) && !isnan(h);

    if (dhtValid) {

      temperature = t;
      humidity = h;

    }

  }

  // Original LDR detection logic
  lightStatus =
    digitalRead(LDR_PIN) == LDR_ACTIVE;

  // Original sound detection logic
  soundStatus =
    digitalRead(SOUND_PIN) == SOUND_ACTIVE;

}
#if ESP_ARDUINO_VERSION_MAJOR >= 3
static void receiveCallback(const esp_now_recv_info_t *info, const uint8_t *data, int len) {
  if (!info) return;
  if (len == sizeof(RoutingControlFrame)) {
    RoutingControlRx control{}; memcpy(control.mac, info->src_addr, 6);
    memcpy(&control.frame, data, sizeof(control.frame)); control.received_at_ms = millis();
    if (control.frame.magic == ROUTING_CONTROL_MAGIC && control.frame.version == ROUTING_CONTROL_VERSION &&
        control.frame.destination_id == NODE_ID && routingControlQueue) xQueueSend(routingControlQueue, &control, 0);
    return;
  }
  if (len != sizeof(MeshPacket)) return;
  RxFrame frame{};
  memcpy(frame.mac, info->src_addr, 6);
  memcpy(&frame.packet, data, sizeof(MeshPacket));
  frame.rssi = info->rx_ctrl ? info->rx_ctrl->rssi : UNKNOWN_I16;
  if (frame.packet.type == PACKET_ACK || frame.packet.type == PACKET_PATH_STATUS || frame.packet.type == PACKET_DELIVERY_REPORT || isChannelSyncType(frame.packet.type)) xQueueSend(rxQueue, &frame, 0);
}
static void sendCallback(const wifi_tx_info_t *, esp_now_send_status_t status) {
  macSendFailed = status != ESP_NOW_SEND_SUCCESS;
}
#else
static void receiveCallback(const uint8_t *mac, const uint8_t *data, int len) {
  if (len == sizeof(RoutingControlFrame)) {
    RoutingControlRx control{}; memcpy(control.mac, mac, 6);
    memcpy(&control.frame, data, sizeof(control.frame)); control.received_at_ms = millis();
    if (control.frame.magic == ROUTING_CONTROL_MAGIC && control.frame.version == ROUTING_CONTROL_VERSION &&
        control.frame.destination_id == NODE_ID && routingControlQueue) xQueueSend(routingControlQueue, &control, 0);
    return;
  }
  if (len != sizeof(MeshPacket)) return;
  RxFrame frame{};
  memcpy(frame.mac, mac, 6);
  memcpy(&frame.packet, data, sizeof(MeshPacket));
  frame.rssi = UNKNOWN_I16;
  if (frame.packet.type == PACKET_ACK || frame.packet.type == PACKET_PATH_STATUS || frame.packet.type == PACKET_DELIVERY_REPORT || isChannelSyncType(frame.packet.type)) xQueueSend(rxQueue, &frame, 0);
}
static void sendCallbackLegacy(const uint8_t *, esp_now_send_status_t status) {
  macSendFailed = status != ESP_NOW_SEND_SUCCESS;
}
#endif
static bool sendPacket() {
  macSendFailed = false;
  return sendBroadcast(currentPacket);
}
static void sendRoutingControlResult(const RoutingControlRx &rx, uint8_t result) {
  RoutingControlFrame response{}; response.magic=ROUTING_CONTROL_MAGIC; response.version=ROUTING_CONTROL_VERSION;
  response.kind=ROUTING_CONTROL_RESULT; response.source_id=NODE_ID; response.destination_id=GATEWAY_ID;
  response.epoch=rx.frame.epoch; response.command_sequence=rx.frame.command_sequence;
  response.evidence_sequence=rx.frame.evidence_sequence; response.expected_next_hop=selectedRelay;
  response.requested_next_hop=rx.frame.requested_next_hop; response.result=result;
  if (addPeer(rx.mac)) esp_now_send(rx.mac,reinterpret_cast<const uint8_t*>(&response),sizeof(response));
}
static void processRoutingControl(const RoutingControlRx &rx) {
  const RoutingControlFrame &f=rx.frame;
  if (channelState!=CHANNEL_STATE_SYNCED || memcmp(rx.mac,gatewayMac,6)!=0 ||
      f.source_id!=GATEWAY_ID || f.magic!=ROUTING_CONTROL_MAGIC || f.version!=ROUTING_CONTROL_VERSION) return;
  if (f.kind==ROUTING_CONTROL_STATE) {
    if (f.epoch<routingControlEpoch || f.enabled>1 || f.ttl_ms==0 || f.ttl_ms>ROUTING_COMMAND_MAX_TTL_MS) return;
    routingControlEpoch=f.epoch; pythonOwnsRoute=f.enabled==1;
    ownershipLeaseMs=f.ttl_ms; lastOwnershipFrameAt=millis();
    routingPrefs.putUInt("epoch",routingControlEpoch);
    Serial.printf("ROUTE_OWNER owner=%s epoch=%lu lease_ms=%lu result=accepted\n",
      pythonOwnsRoute?"PYTHON":"FIRMWARE",(unsigned long)routingControlEpoch,(unsigned long)ownershipLeaseMs);
    sendRoutingControlResult(rx,ROUTING_RESULT_APPLIED); return;
  }
  if (f.kind!=ROUTING_CONTROL_COMMAND) return;
  if (f.command_sequence==lastPythonCommandSequence) {
    sendRoutingControlResult(rx,lastPythonCommandResult); return;
  }
  uint8_t result=ROUTING_RESULT_REJECTED;
  if (!pythonOwnsRoute || f.epoch!=routingControlEpoch || f.command_sequence<lastPythonCommandSequence) {
    result=ROUTING_RESULT_REJECTED;
  } else if (!f.ttl_ms || f.ttl_ms>ROUTING_COMMAND_MAX_TTL_MS || millis()-rx.received_at_ms>=f.ttl_ms) {
    result=ROUTING_RESULT_EXPIRED;
  } else if (waitingForAck || f.expected_next_hop!=selectedRelay ||
             (f.requested_next_hop!=2 && f.requested_next_hop!=3)) {
    result=ROUTING_RESULT_REJECTED;
  } else if (f.requested_next_hop==selectedRelay) {
    result=ROUTING_RESULT_NO_CHANGE;
  } else {
    const CandidatePath &candidate=candidateFor(f.requested_next_hop);
    if (candidate.gatewayAvailabilityKnown && candidate.gatewayAvailable && pathStatusFresh(candidate,millis()) &&
        candidate.attempts>=PATH_MIN_SAMPLES && candidate.responses>0 && candidate.pathHops>0 &&
        candidate.pathHops<MAX_HOPS) {
      selectedRelay=f.requested_next_hop; lastRouteChange=millis(); lastRouteChangeReason="python_autonomous_command";
      currentDecision.nextHop=selectedRelay; currentDecision.mode=selectedRelay==2?ROUTING_ML_UPPER:ROUTING_ML_LOWER;
      currentDecision.reason="python_autonomous_command"; result=ROUTING_RESULT_APPLIED;
    }
  }
  if (f.command_sequence>lastPythonCommandSequence) {
    lastPythonCommandSequence=f.command_sequence; lastPythonCommandResult=result;
    routingPrefs.putUInt("command",lastPythonCommandSequence);
    routingPrefs.putUChar("result",lastPythonCommandResult);
  }
  Serial.printf("ROUTE_COMMAND seq=%lu epoch=%lu expected=%u requested=%u result=%u active=%u\n",
    (unsigned long)f.command_sequence,(unsigned long)f.epoch,f.expected_next_hop,f.requested_next_hop,result,selectedRelay);
  sendRoutingControlResult(rx,result);
}
static void serviceRoutingControl() {
  if (pythonOwnsRoute && ownershipLeaseMs && millis()-lastOwnershipFrameAt>ownershipLeaseMs) {
    pythonOwnsRoute=false; ownershipLeaseMs=0;
    Serial.printf("ROUTE_OWNER owner=FIRMWARE epoch=%lu reason=lease_expired fallback=embedded_decision_tree\n",
      (unsigned long)routingControlEpoch);
  }
  if (waitingForAck || !routingControlQueue) return;
  RoutingControlRx rx{};
  if (xQueueReceive(routingControlQueue,&rx,0)==pdTRUE) processRoutingControl(rx);
}
static void makePacket(const RouteDecision &decision) {
  memset(&currentPacket, 0, sizeof(currentPacket));
  currentPacket.version = PROTOCOL_VERSION;
  currentPacket.type = PACKET_DATA;
  copyText(currentPacket.project_id, sizeof(currentPacket.project_id), PROJECT_ID);
  copyText(currentPacket.network_id, sizeof(currentPacket.network_id), NETWORK_ID);
  copyText(currentPacket.experiment_id, sizeof(currentPacket.experiment_id), EXPERIMENT_ID);
  currentPacket.source_id = NODE_ID;
  currentPacket.destination_id = GATEWAY_ID;
  currentPacket.next_hop_id = decision.nextHop;
  currentPacket.forwarding_node_id = NODE_ID;
  currentPacket.routing_algorithm = decision.mode;
  currentPacket.sequence = sequenceNumber++;
  currentPacket.source_uptime_ms = millis();
  currentPacket.hop_limit = MAX_HOPS;
  currentPacket.temperature_centi_c = dhtValid ? lroundf(temperature * 100.0f) : UNKNOWN_I16;
  currentPacket.humidity_centi_percent = dhtValid ? lroundf(humidity * 100.0f) : UNKNOWN_U16;
  currentPacket.light_status = lightStatus ? 1 : 0;
  currentPacket.sound_detected = soundStatus ? 1 : 0;
  currentPacket.last_hop_rssi_dbm = lastAckRssi;
  double measuredPdr = 0.0, measuredLatencyMs = 0.0;
  const CandidatePath &path = candidateFor(decision.nextHop);
  if (candidateMetricsAvailable(path, millis(), measuredPdr, measuredLatencyMs)) {
    currentPacket.latency_ms = (uint16_t)min((double)UINT16_MAX, round(measuredLatencyMs));
    currentPacket.packet_loss_percent = (uint8_t)min(100.0, round((1.0 - measuredPdr) * 100.0));
  } else {
    currentPacket.latency_ms = UNKNOWN_U16;
    currentPacket.packet_loss_percent = 255;
  }
  currentPacket.throughput_bps = measuredThroughputBps;
  currentPacket.selected_next_hop_id = decision.nextHop;
  currentPacket.feature_valid = decision.featuresValid ? 1 : 0;
  currentPacket.predicted_class = decision.featuresValid ? (int8_t)decision.prediction : -99;
  currentPacket.source_packets_sent = sentPackets + 1;
  currentPacket.route_change_reason =
    !strcmp(decision.reason, "model_class_upper") ? 1 :
    !strcmp(decision.reason, "model_class_lower") ? 2 :
    !strcmp(decision.reason, "required_candidate_metrics_missing_or_stale") ? 3 :
    !strcmp(decision.reason, "both_paths_unavailable") ? 4 :
    !strcmp(decision.reason, "model_no_usable_route") ? 5 :
    !strcmp(decision.reason, "baseline_experiment_override") ? 6 : 0;
  const auto features = p12ganesh::ml::values(decision.features);
  for (size_t i = 0; i < 8; ++i)
    currentPacket.model_features[i] = decision.featuresValid ? (float)features[i] : NAN;
}
static void handleAcks() {
  RxFrame frame{};
  while (xQueueReceive(rxQueue, &frame, 0) == pdTRUE) {
    const MeshPacket &ack = frame.packet;
    if (isChannelSyncType(ack.type)) { processChannelSyncFrame(frame); continue; }
    if (channelState != CHANNEL_STATE_SYNCED) continue;
    if (ack.type == PACKET_DELIVERY_REPORT) {
      if (ack.version == PROTOCOL_VERSION && ack.source_id == GATEWAY_ID && ack.destination_id == NODE_ID &&
          !strncmp(ack.project_id, PROJECT_ID, sizeof(ack.project_id)) &&
          !strncmp(ack.network_id, NETWORK_ID, sizeof(ack.network_id)) &&
          !strncmp(ack.experiment_id, EXPERIMENT_ID, sizeof(ack.experiment_id)) &&
          ack.next_hop_id == NODE_ID && ack.sequence == pendingDeliverySequence &&
          ack.source_uptime_ms == pendingDeliveryUptime && ack.forwarding_node_id == selectedRelay &&
          ack.routing_algorithm == currentPacket.routing_algorithm && ack.hop_count == 2) {
        deliveryState = DELIVERY_CONFIRMED; deliveredViaRelay = ack.forwarding_node_id;
        uint32_t now = millis();
        if (ack.sequence != lastCountedDeliverySequence) {
          if (!throughputWindowStart || now - throughputWindowStart >= 30000UL) {
            throughputWindowStart = now; deliveredCount = 0; deliveredBits = 0; measuredThroughputBps = UNKNOWN_U32;
          }
          deliveredBits += (uint64_t)sizeof(MeshPacket) * 8ULL;
          ++deliveredCount; lastCountedDeliverySequence = ack.sequence;
          uint32_t elapsed = now - throughputWindowStart;
          if (deliveredCount >= 2 && elapsed) {
            uint64_t rate = deliveredBits * 1000ULL / elapsed;
            measuredThroughputBps = rate > UINT32_MAX ? UINT32_MAX : (uint32_t)rate;
          }
        }
        Serial.printf("DELIVERY_CONFIRMED seq=%lu prediction=%d selected=ESP32_%02u result=forwarded confirmation_rtt_ms=%lu mode=%s hop_count=%u\n",
          (unsigned long)ack.sequence,currentDecision.prediction,deliveredViaRelay,(unsigned long)(now-deliveryStartedAt),
          ack.routing_algorithm==ROUTING_ML_UPPER||ack.routing_algorithm==ROUTING_ML_LOWER?"ML_ACTIVE":"BASELINE_FALLBACK",ack.hop_count);
      }
      continue;
    }
    if (ack.type == PACKET_PATH_STATUS) { recordPathStatus(frame); continue; }
    if (ack.version != PROTOCOL_VERSION || ack.type != PACKET_ACK ||
        (ack.source_id != 2 && ack.source_id != 3) || ack.source_id != selectedRelay ||
        ack.next_hop_id != NODE_ID || ack.sequence != currentPacket.sequence ||
        ack.source_uptime_ms != currentPacket.source_uptime_ms || !waitingForAck) continue;
    waitingForAck = false;
    ++ackedPackets;
    lastAckRtt = millis() - lastSend;
    lastAckRssi = frame.rssi;
    lastAckRelay = ack.source_id; lastAckAt = millis();
    lastCommunicationAt = lastAckAt; lastAckSucceeded = true; hasTxResult = true;
    transmissions = 0;
    setLED(false, false, true);
    Serial.printf("ACK_OK seq=%lu relay=%u mode=%u prediction=%d rtt_ms=%lu rssi_dbm=%d ack=yes\n",
      (unsigned long)ack.sequence,ack.source_id,currentPacket.routing_algorithm,currentDecision.prediction,
      (unsigned long)lastAckRtt,lastAckRssi);
  }
}
static void serviceMesh() {
  handleAcks();
  serviceRoutingControl();
  if (channelState != CHANNEL_STATE_SYNCED) return;
  if (deliveryState == DELIVERY_PENDING && millis() - deliveryStartedAt > DELIVERY_REPORT_TIMEOUT) {
    deliveryState = DELIVERY_UNCONFIRMED;
    Serial.printf("DELIVERY_UNCONFIRMED seq=%lu prediction=%d selected=ESP32_%02u result=no_gateway_confirmation mode=%s\n",
      (unsigned long)pendingDeliverySequence,currentDecision.prediction,selectedRelay,
      currentPacket.routing_algorithm==ROUTING_ML_UPPER||currentPacket.routing_algorithm==ROUTING_ML_LOWER?"ML_NOT_CONFIRMED":"BASELINE_UNCONFIRMED");
  }
  if (waitingForAck) {
    if (!macSendFailed && millis() - lastSend < ACK_TIMEOUT) return;
    if (transmissions < MAX_TRANSMISSIONS) {
      ++transmissions; ++retryPackets;
      if (sendPacket()) { lastSend = millis(); setLED(false, true, false); }
      else macSendFailed = true;
      return;
    }
    ++failedPackets;
    lastAckSucceeded = false; hasTxResult = true;
    Serial.printf("SEND_FAILED seq=%lu attempts=%u\n", (unsigned long)currentPacket.sequence, transmissions);
    waitingForAck = false; transmissions = 0;
    setLED(true, false, false);
    return;
  }
  if (servicePathProbe()) return;
  if (millis() - lastSend < SEND_INTERVAL) return;
  RouteDecision decision = selectRoute();
  currentDecision = decision;
  setLED(false, true, false);
  if (!decision.nextHop) {
    if (!pythonOwnsRoute) {
      if (selectedRelay != 0) { lastRouteChangeReason = decision.reason; lastRouteChange = millis(); }
      selectedRelay = 0;
    }
    deliveryState = DELIVERY_NONE;
    lastSend = millis(); setLED(true, false, false);
    if (!decision.featuresValid) Serial.printf("ML INPUTS UNAVAILABLE; ");
    Serial.printf("ROUTE_DECISION uptime=%lu source=1 current=1 candidates=2,3 features_valid=%s prediction=%d selected=none mode=NO_VALID_ROUTE reason=%s\n",
      (unsigned long)millis(), decision.featuresValid ? "true" : "false", decision.prediction, decision.reason);
    return;
  }
  bool changed = selectedRelay != decision.nextHop;
  selectedRelay = decision.nextHop;
  if (changed) { lastRouteChange = millis(); lastRouteChangeReason = decision.reason; }
  makePacket(decision);
  currentPacket.route_change = changed ? 1 : 0;
  if (!changed) currentPacket.route_change_reason = 0;
  ++sentPackets;
  transmissions = 1;
  waitingForAck = true;
  bool txQueued = sendPacket();
  if (txQueued) lastSend = millis();
  else macSendFailed = true;
  pendingDeliverySequence = currentPacket.sequence;
  pendingDeliveryUptime = currentPacket.source_uptime_ms;
  deliveryStartedAt = millis();
  deliveryState = DELIVERY_PENDING;
  if (decision.featuresValid) {
    Serial.printf("ROUTE_DECISION uptime=%lu source=1 current=1 candidates=2,3 features=[%.4f,%.4f,%.2f,%.0f,%.4f,%.4f,%.2f,%.0f] features_valid=true prediction=%d selected=%u mode=%s result=%s ack=pending hop_count=0 route_change=%s reason=%s\n",
      (unsigned long)millis(),decision.features.upper_available,decision.features.upper_pdr_estimate,decision.features.upper_latency_ms,decision.features.upper_hops,
      decision.features.lower_available,decision.features.lower_pdr_estimate,decision.features.lower_latency_ms,decision.features.lower_hops,
      decision.prediction,decision.nextHop,decision.mode==ROUTING_ML_UPPER||decision.mode==ROUTING_ML_LOWER?"ML_PENDING":"BASELINE_FALLBACK",
      changed?"selected":"pending",changed?"yes":"no",decision.reason);
  } else {
    Serial.printf("ML INPUTS UNAVAILABLE; ROUTE_DECISION uptime=%lu source=1 current=1 candidates=2,3 features_valid=false prediction=unavailable selected=%u mode=BASELINE_FALLBACK result=pending hop_count=0 route_change=%s reason=%s\n",
      (unsigned long)millis(),decision.nextHop,changed?"yes":"no",decision.reason);
  }
  Serial.printf("SOURCE_SEND node=%s seq=%lu next_hop=%u routing_algorithm=%u tx=%s ack=pending\n", NODE_NAME,
    (unsigned long)currentPacket.sequence,currentPacket.next_hop_id,currentPacket.routing_algorithm,txQueued?"queued":"local_error");
}
static void drawScreen() {
  if (!oledReady || millis() - lastScreen < 500) return;
  lastScreen = millis();
  if (millis() - lastRotation >= 3500) { screen = (screen + 1) % 6; lastRotation = millis(); }
  display.setTextWrap(false);
  display.clearDisplay(); display.setTextColor(SH110X_WHITE); display.setTextSize(1); display.setCursor(0, 0);
  if (screen == 0) {
    display.println("P12-IOT");
    display.println("ML Mesh Routing");
    display.println("Node: ESP32_01");
    display.println("CraftIQ");
    display.printf("Firmware: %s", FIRMWARE_VERSION);
  } else if (screen == 1) {
    display.println("LIVE SENSORS");
    display.printf("Temp: %s C\n", dhtValid ? String(temperature, 1).c_str() : "--");
    display.printf("Humidity: %s %%\n", dhtValid ? String(humidity, 1).c_str() : "--");
    display.printf("Light: %s\n", lightStatus ? "DETECTED" : "NOT DETECTED");
    display.printf("Sound: %s\n", soundStatus ? "DETECTED" : "NOT DETECTED");
    display.printf("Validity: %s", dhtValid ? "VALID" : "INVALID");
  } else if (screen == 2) {
    display.println("ESP-NOW LINK");
    display.printf("Status: %s\n", channelState == CHANNEL_STATE_SYNCED ? "SYNCED" : "SEARCHING");
    display.printf("Next hop: %s\n", selectedRelay ? (selectedRelay == 2 ? "ESP32_02" : "ESP32_03") : "NONE");
    display.printf("ACK: %s", waitingForAck ? "PENDING" : hasTxResult ? (lastAckSucceeded ? "OK" : "FAILED") : "N/A");
  } else if (screen == 3) {
    display.println("ML ROUTING");
    if (currentDecision.featuresValid) display.println(P12_FORCE_BASELINE ? "Inference: DISABLED" : "Inference: RAN");
    else display.println("ML INPUTS UNAVAILABLE");
    const char *mode = currentDecision.mode == ROUTING_NO_VALID_ROUTE ? "NO_VALID_ROUTE" :
      currentDecision.mode == ROUTING_BASELINE_FALLBACK ? "BASELINE_FALLBACK" :
      deliveryState == DELIVERY_CONFIRMED ? "ML_ACTIVE" :
      deliveryState == DELIVERY_UNCONFIRMED ? "ML_NOT_CONFIRMED" : "ML_PENDING";
    display.println(mode);
    if (currentDecision.featuresValid)
      display.printf("%s\n", P12_FORCE_BASELINE ? "Pred: BASELINE" : currentDecision.prediction == 0 ? "Pred: UPPER (0)" : currentDecision.prediction == 1 ? "Pred: LOWER (1)" : "Pred: NO ROUTE (-1)");
    display.printf("Next: %s\n", selectedRelay ? (selectedRelay == 2 ? "ESP32_02" : "ESP32_03") : "NONE");
    display.printf("2:%s 3:%s\n", candidateState(candidates[0],millis()), candidateState(candidates[1],millis()));
    display.printf("Result: %s\n", deliveryState == DELIVERY_PENDING ? "PENDING" : deliveryState == DELIVERY_CONFIRMED ? "GATEWAY OK" : deliveryState == DELIVERY_UNCONFIRMED ? "NO CONFIRM" : "N/A");
    display.printf("Why: %.16s", shortRouteReason(lastRouteChangeReason));
  } else if (screen == 4) {
    display.println("TX COUNTERS");
    display.printf("Sent: %lu\n", (unsigned long)sentPackets);
    display.printf("ACKed: %lu\n", (unsigned long)ackedPackets);
    display.printf("Failed: %lu\n", (unsigned long)failedPackets);
    display.printf("Retries: %lu\n", (unsigned long)retryPackets);
    display.printf("Seq: %lu\n", (unsigned long)currentPacket.sequence);
    display.printf("Hop: %u\n", currentPacket.hop_count);
    display.printf("ACK: %s", waitingForAck ? "PENDING" : hasTxResult ? (lastAckSucceeded ? "OK" : "FAILED") : "N/A");
  } else {
    display.println("NETWORK / CLOUD");
    display.println("Cloud via node 4");
    display.println("WiFi on gateway");
    display.printf("Net: %s\n", NETWORK_ID);
    display.printf("Radio ch: %u\n", meshChannel);
    if (lastCommunicationAt) display.printf("Mesh age: %lu s", (unsigned long)((millis() - lastCommunicationAt) / 1000));
    else display.println("Last mesh: N/A");
  }
  display.display();
}
void setup() {
  Serial.begin(115200);
  pinMode(LDR_PIN, INPUT); pinMode(SOUND_PIN, INPUT);
  pinMode(LED_RED, OUTPUT); pinMode(LED_YELLOW, OUTPUT); pinMode(LED_GREEN, OUTPUT);
  setLED(false, false, false);
  digitalWrite(LED_RED, LOW); digitalWrite(LED_YELLOW, LOW); digitalWrite(LED_GREEN, LOW);
  dht.begin(); Wire.begin(OLED_SDA, OLED_SCL);
  oledReady = display.begin(OLED_ADDRESS, true);
  rxQueue = xQueueCreate(8, sizeof(RxFrame));
  if (!rxQueue) { Serial.println("ERROR ack_queue"); while (true) delay(1000); }
  routingControlQueue=xQueueCreate(4,sizeof(RoutingControlRx));
  if(!routingControlQueue) Serial.println("ROUTE_CONTROL_UNAVAILABLE reason=queue_allocation_failed owner=firmware_fallback");
  if(routingPrefs.begin("p12route",false)) {
    routingControlEpoch=routingPrefs.getUInt("epoch",0);
    lastPythonCommandSequence=routingPrefs.getUInt("command",0);
    lastPythonCommandResult=routingPrefs.getUChar("result",ROUTING_RESULT_REJECTED);
  }
  WiFi.mode(WIFI_STA); WiFi.setSleep(false);
  esp_wifi_set_channel(MESH_BOOT_CHANNEL, WIFI_SECOND_CHAN_NONE);
  configureChannelScanRange();
    if (esp_now_init() != ESP_OK) { Serial.println("ERROR esp_now_init"); while (true) delay(1000); }
  espNowReady = true;
  addPeer(BROADCAST_MAC);
  esp_now_register_recv_cb(receiveCallback);
#if ESP_ARDUINO_VERSION_MAJOR >= 3
  esp_now_register_send_cb(sendCallback);
#else
  esp_now_register_send_cb(sendCallbackLegacy);
#endif
  lastSend = millis() - SEND_INTERVAL; lastSensorRead = millis() - SENSOR_INTERVAL;
  lastPathProbe = millis() - PATH_PROBE_INTERVAL;
  startChannelScan("boot");
  Serial.printf("READY %s channel=%u mac=%s mesh=discovering\n", NODE_NAME, meshChannel, WiFi.macAddress().c_str());
}
void loop() {
  readSensors(); serviceChannelSync(); serviceMesh(); drawScreen();
  serviceStatusLED(waitingForAck);
  delay(1);
}
