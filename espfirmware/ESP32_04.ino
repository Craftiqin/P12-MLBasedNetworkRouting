#include <array>
#include <cmath>

// Generated by ml/train_tree.py. Synthetic route scenario model; not hardware-trained.
namespace p12ganesh::ml {
inline constexpr const char *MODEL_VERSION = "decision-tree-v1-seed-20261101";
struct RouteFeatures {
    double upper_available, upper_pdr_estimate, upper_latency_ms, upper_hops;
    double lower_available, lower_pdr_estimate, lower_latency_ms, lower_hops;
};
inline std::array<double, 8> values(const RouteFeatures& f) {
    return {f.upper_available, f.upper_pdr_estimate, f.upper_latency_ms, f.upper_hops,
            f.lower_available, f.lower_pdr_estimate, f.lower_latency_ms, f.lower_hops};
}
inline constexpr int feature[21] = {1, 4, -2, 5, 5, -2, -2, -2, 2, 5, 5, -2, -2, 1, -2, -2, 5, 1, -2, -2, -2};
inline constexpr int left[21] = {1, 2, -1, 4, 5, -1, -1, -1, 9, 10, 11, -1, -1, 14, -1, -1, 17, 18, -1, -1, -1};
inline constexpr int right[21] = {8, 3, -1, 7, 6, -1, -1, -1, 16, 13, 12, -1, -1, 15, -1, -1, 20, 19, -1, -1, -1};
inline constexpr double threshold[21] = {0.907467335463, 0.5, -2, 0.865931242704, 0.859115302563, -2, -2, -2, 119.210910797, 0.995044529438, 0.962451845407, -2, -2, 0.984755635262, -2, -2, 0.919160217047, 0.980703085661, -2, -2, -2};
inline constexpr int leaf_label[21] = {1, 1, -1, 1, 1, 1, 1, 1, 0, 0, 0, 0, 0, 1, 1, 0, 1, 0, 1, 0, 1};
inline int predict(const RouteFeatures& input) {
    const auto x = values(input);
    for (double value : x) if (!std::isfinite(value)) return -2;
    int node = 0;
    while (left[node] != -1) node = (x[feature[node]] <= threshold[node]) ? left[node] : right[node];
    return leaf_label[node];
}
inline double expectedCost(double pdr, double latencyMs) {
    return pdr * latencyMs + (1.0 - pdr) * 1000.0;
}
inline bool usable(bool available, double pdr, double latencyMs, double hops) {
    return available && std::isfinite(pdr) && pdr >= 0 && pdr <= 1 &&
           std::isfinite(latencyMs) && latencyMs >= 0 && std::isfinite(hops) && hops >= 1;
}
inline int selectSafely(int prediction, const RouteFeatures& f) {
    const bool upper = usable(f.upper_available >= 0.5, f.upper_pdr_estimate, f.upper_latency_ms, f.upper_hops);
    const bool lower = usable(f.lower_available >= 0.5, f.lower_pdr_estimate, f.lower_latency_ms, f.lower_hops);
    if (prediction == 0 && upper) return 0;
    if (prediction == 1 && lower) return 1;
    if (!upper && !lower) return -1;
    if (!upper) return 1;
    if (!lower) return 0;
    const double upperCost = expectedCost(f.upper_pdr_estimate, f.upper_latency_ms);
    const double lowerCost = expectedCost(f.lower_pdr_estimate, f.lower_latency_ms);
    if (upperCost != lowerCost) return upperCost < lowerCost ? 0 : 1;
    return f.upper_hops <= f.lower_hops ? 0 : 1;
}
} // namespace p12ganesh::ml

// P12-IOT ESP32_04 — mesh gateway and HTTPS publisher.
#include <Arduino.h>
#include <WiFi.h>
#include <esp_now.h>
#include <esp_wifi.h>
#include <esp_arduino_version.h>
#include <freertos/FreeRTOS.h>
#include <freertos/queue.h>
#include <WiFiClientSecure.h>
#include <HTTPClient.h>
#include <esp_heap_caps.h>
#include <string.h>
#include <limits.h>
#include <time.h>

static constexpr char PROJECT_ID[] = "P12-IOT";
static constexpr char NETWORK_ID[] = "P12-MESH-01";
static constexpr char EXPERIMENT_ID[] = "EXP-003";
static constexpr char API_HOST[] = "api.craftiq.in";
static constexpr uint16_t API_PORT = 443;
static constexpr uint8_t PROTOCOL_VERSION = 2;
#define NODE_ID 4
static constexpr uint8_t PACKET_DATA = 1;
static constexpr uint8_t PACKET_ACK = 2;
static constexpr uint8_t PACKET_PATH_PROBE = 3;
static constexpr uint8_t PACKET_PATH_STATUS = 4;
static constexpr uint8_t PACKET_DELIVERY_REPORT = 7;
static constexpr uint8_t PACKET_GATEWAY_PROBE = 5;
static constexpr uint8_t PACKET_GATEWAY_PROBE_ACK = 6;
static constexpr uint8_t PACKET_GATEWAY_BEACON = 8;
static constexpr uint8_t PACKET_CHANNEL_SYNC_REQUEST = 9;
static constexpr uint8_t PACKET_CHANNEL_SYNC_RESPONSE = 10;
static constexpr uint8_t PACKET_CHANNEL_SYNC_ACK = 11;
static constexpr uint8_t PACKET_CHANNEL_CHANGE_NOTICE = 12;
static constexpr uint8_t SYNC_MARKER = 0xD2;
static constexpr uint8_t SYNC_ROUTE_MARKER = 0xC3;
static constexpr uint32_t SYNC_MAGIC = 0x50313243UL;
static constexpr uint32_t CHANNEL_BEACON_INTERVAL_MS = 250UL;
static constexpr uint32_t CHANNEL_NODE_LEASE_MS = 15000UL;
static constexpr uint8_t ROUTING_BASELINE_FALLBACK = 1;
static constexpr uint8_t ROUTING_ML_UPPER = 2;
static constexpr uint8_t ROUTING_ML_LOWER = 3;
static constexpr uint8_t ROUTING_NO_VALID_ROUTE = 4;
static constexpr uint8_t GATEWAY_ID = 4;
static constexpr uint8_t MESH_BOOT_CHANNEL = 1;
static uint8_t meshChannel = 1;
static constexpr uint8_t MAX_HOPS = 4;
static constexpr uint8_t LIGHT_UNKNOWN = 255;
static constexpr int16_t UNKNOWN_I16 = INT16_MIN;
static constexpr uint16_t UNKNOWN_U16 = UINT16_MAX;
static constexpr uint32_t UNKNOWN_U32 = UINT32_MAX;

struct __attribute__((packed)) MeshPacket {
  uint8_t version;
  uint8_t type;
  char project_id[8];
  char network_id[12];
  char experiment_id[8];
  uint8_t source_id;
  uint8_t destination_id;
  uint8_t next_hop_id;
  uint8_t forwarding_node_id;
  uint8_t routing_algorithm;
  uint32_t sequence;
  uint32_t source_uptime_ms;
  uint8_t hop_count;
  uint8_t hop_limit;
  int16_t temperature_centi_c;
  uint16_t humidity_centi_percent;
  uint8_t light_status;
  uint8_t sound_detected;
  int16_t last_hop_rssi_dbm;
  uint16_t latency_ms;
  uint8_t packet_loss_percent;
  uint32_t throughput_bps;
  uint8_t feature_valid;
  int8_t predicted_class;
  uint8_t route_change;
  uint8_t route_change_reason;
  uint8_t selected_next_hop_id;
  uint32_t source_packets_sent;
  float model_features[8];
};
static_assert(sizeof(MeshPacket) <= 250, "ESP-NOW payload too large");

struct RxFrame { uint8_t mac[6]; MeshPacket packet; int16_t rssi; };
struct SeenKey { uint8_t source; uint32_t sequence; uint32_t uptime; };

class P12TrackedTlsClient : public WiFiClientSecure {
 public:
  uint32_t connectAttempts=0,connectElapsedMs=0;
  int connectResult=0;
  size_t headerBytesAttempted=0,headerBytesWritten=0;
  size_t bodyBytesAttempted=0,bodyBytesWritten=0;
  bool bodyStarted=false;
  uint8_t headerTerminatorMatch=0;

  int connect(const char*host,uint16_t port,int32_t timeout) override {
    ++connectAttempts;
    const uint32_t started=millis();
    connectResult=WiFiClientSecure::connect(host,port,timeout);
    connectElapsedMs=millis()-started;
    return connectResult;
  }

  size_t write(const uint8_t*data,size_t size) override {
    const bool wasBody=bodyStarted;
    const size_t written=WiFiClientSecure::write(data,size);
    if(wasBody){
      bodyBytesAttempted+=size;
      bodyBytesWritten+=written;
    }else{
      headerBytesAttempted+=size;
      headerBytesWritten+=written;
      for(size_t i=0;i<size&&!bodyStarted;++i){
        const char c=static_cast<char>(data[i]);
        if((headerTerminatorMatch==0||headerTerminatorMatch==2)&&c=='\r')++headerTerminatorMatch;
        else if((headerTerminatorMatch==1||headerTerminatorMatch==3)&&c=='\n'){
          ++headerTerminatorMatch;
          if(headerTerminatorMatch==4)bodyStarted=true;
        }else headerTerminatorMatch=(c=='\r')?1:0;
      }
    }
    return written;
  }

  size_t write(uint8_t value) override { return write(&value,1); }
};

static volatile bool wifiReady=false;
static uint32_t lastChannelBeaconAt=0,channelBeaconSequence=0;
static uint8_t previousMeshChannel=0;
static bool channelNoticePending=false,meshReadyReported=false;
static uint32_t channelSyncRequestSequence[4]{},channelSyncRequestUptime[4]{},channelSyncAckAt[4]{};
static uint8_t channelSyncMac[4][6]{};


static bool isChannelSyncType(uint8_t type);
static bool validChannelSyncPacket(const MeshPacket &p);
static MeshPacket makeChannelSyncPacket(uint8_t type,uint8_t source,uint8_t destination,uint8_t channel,uint32_t sequence,uint32_t uptime);
static bool processChannelSyncFrame(const RxFrame &frame);
static void serviceChannelSync();

static bool addPeer(const uint8_t *mac);
// Keep all declarations after custom types: Arduino may inject prototypes before definitions.
static bool sendBroadcast(const MeshPacket &packet);
static void copyText(char *dst, size_t size, const char *src);
static void countRxQueueOverflow();
static uint32_t readRxQueueOverflows();
#if ESP_ARDUINO_VERSION_MAJOR >= 3
static void receiveCallback(const esp_now_recv_info_t *info,const uint8_t *data,int len);
#else
static void receiveCallback(const uint8_t *mac,const uint8_t *data,int len);
#endif
static void remember(const MeshPacket &p);
static bool seenBefore(const MeshPacket &p);
static void sendAck(uint8_t previous,uint32_t seq,uint32_t uptime,const uint8_t *mac);
static void sendDeliveryReport(const MeshPacket &p,const uint8_t *mac);
static void sendGatewayProbeAck(const RxFrame &f);
static void processIncoming(const RxFrame &f);
static void serviceRx();
static String metricI16(int16_t v);
static String metricU16(uint16_t v);
static String metricU32(uint32_t v);
static String makeJson(const MeshPacket &p);
static String reasonName(uint8_t code);
static String modeName(uint8_t mode);
static String featureJson(float v);
static String makeRoutingJson(const MeshPacket &p);
static const char* apiEndpointName(const char *url);
static const char* httpStatusName(int status);
static const char* transportErrorName(int status);
static const char* postFailurePhase(int status,const P12TrackedTlsClient&tls);
static const char* postFailureClass(int status,int tlsCode,const P12TrackedTlsClient&tls);
static void logTlsHeap(const char *endpoint);
static String sanitizeApiLogText(String value);
static bool postJson(const char *url,const String &body);
static bool publishOne(const MeshPacket &p);
static bool publishRoutingEvent(const MeshPacket &p);
static bool peekTelemetry(MeshPacket &out);
static bool peekRoutingEvent(MeshPacket &out);
static uint8_t queuedTelemetry();
static uint8_t queuedRoutingEvents();
static bool sameQueuePacket(const MeshPacket &a,const MeshPacket &b);
static void removePublishedTelemetry(const MeshPacket &p);
static void removePublishedRoutingEvent(const MeshPacket &p);
static void reconnectWiFi();
static void serviceWiFi();
static bool systemClockValid();
static void serviceClockSync();
static void initWifi();
static void uploadTask(void *);
static void requestStatusLED(uint8_t color,uint32_t holdMs);
static void serviceStatusLED(bool errorActive,bool processingActive);
void setup();
void loop();

static constexpr uint8_t BROADCAST_MAC[6] = {0xFF,0xFF,0xFF,0xFF,0xFF,0xFF};
static bool addPeer(const uint8_t *mac) {
  if (esp_now_is_peer_exist(mac)) return true;
  esp_now_peer_info_t peer{};
  memcpy(peer.peer_addr, mac, 6);
  peer.channel = 0;
  peer.ifidx = WIFI_IF_STA;
  peer.encrypt = false;
  return esp_now_add_peer(&peer) == ESP_OK;
}
static bool sendBroadcast(const MeshPacket &packet) {
  return esp_now_send(BROADCAST_MAC, reinterpret_cast<const uint8_t *>(&packet), sizeof(packet)) == ESP_OK;
}
static void copyText(char *dst, size_t size, const char *src) {
  strncpy(dst, src, size - 1);
  dst[size - 1] = '\0';
}

static bool isChannelSyncType(uint8_t type) { return type>=PACKET_GATEWAY_BEACON&&type<=PACKET_CHANNEL_CHANGE_NOTICE; }
static bool validChannelSyncPacket(const MeshPacket &p) {
  return p.version==PROTOCOL_VERSION&&isChannelSyncType(p.type)&&
    !strncmp(p.project_id,PROJECT_ID,sizeof(p.project_id))&&
    !strncmp(p.network_id,NETWORK_ID,sizeof(p.network_id))&&
    !strncmp(p.experiment_id,EXPERIMENT_ID,sizeof(p.experiment_id))&&
    p.routing_algorithm==SYNC_MARKER&&p.feature_valid==0xA5&&p.predicted_class==-42&&
    p.route_change==SYNC_ROUTE_MARKER&&p.route_change_reason==0x51&&p.hop_count==0x5A&&p.hop_limit==0xA5&&
    p.source_packets_sent==SYNC_MAGIC&&p.next_hop_id>=1&&p.next_hop_id<=13&&p.selected_next_hop_id==p.next_hop_id;
}
static MeshPacket makeChannelSyncPacket(uint8_t type,uint8_t source,uint8_t destination,uint8_t channel,uint32_t sequence,uint32_t uptime) {
  MeshPacket p{};p.version=PROTOCOL_VERSION;p.type=type;copyText(p.project_id,sizeof(p.project_id),PROJECT_ID);
  copyText(p.network_id,sizeof(p.network_id),NETWORK_ID);copyText(p.experiment_id,sizeof(p.experiment_id),EXPERIMENT_ID);
  p.source_id=source;p.destination_id=destination;p.next_hop_id=channel;p.selected_next_hop_id=channel;
  p.routing_algorithm=SYNC_MARKER;p.sequence=sequence;p.source_uptime_ms=uptime;p.hop_count=0x5A;p.hop_limit=0xA5;
  p.feature_valid=0xA5;p.predicted_class=-42;p.route_change=SYNC_ROUTE_MARKER;p.route_change_reason=0x51;p.source_packets_sent=SYNC_MAGIC;return p;
}
static bool processChannelSyncFrame(const RxFrame &frame) {
  const MeshPacket &p=frame.packet;
  if(!isChannelSyncType(p.type))return false;
  if(!wifiReady||!validChannelSyncPacket(p)||p.next_hop_id!=meshChannel)return true;
  uint8_t slot=p.source_id;
  if(p.type==PACKET_CHANNEL_SYNC_REQUEST&&slot>=1&&slot<=3&&p.destination_id==NODE_ID) {
    channelSyncRequestSequence[slot]=p.sequence;channelSyncRequestUptime[slot]=p.source_uptime_ms;
    memcpy(channelSyncMac[slot],frame.mac,6);
    MeshPacket response=makeChannelSyncPacket(PACKET_CHANNEL_SYNC_RESPONSE,NODE_ID,slot,meshChannel,p.sequence,p.source_uptime_ms);
    if(addPeer(frame.mac))esp_now_send(frame.mac,reinterpret_cast<const uint8_t*>(&response),sizeof(response));
    return true;
  }
  if(p.type==PACKET_CHANNEL_SYNC_ACK&&slot>=1&&slot<=3&&p.destination_id==NODE_ID&&
     p.sequence==channelSyncRequestSequence[slot]&&p.source_uptime_ms==channelSyncRequestUptime[slot]&&
     memcmp(frame.mac,channelSyncMac[slot],6)==0) {
    bool fresh=!channelSyncAckAt[slot]||millis()-channelSyncAckAt[slot]>CHANNEL_NODE_LEASE_MS;
    channelSyncAckAt[slot]=millis();
    if(fresh)Serial.printf("NODE_CHANNEL_SYNC node=%u channel=%u result=success\n",slot,meshChannel);
    return true;
  }
  return true;
}
static void serviceChannelSync() {
  if(!wifiReady||WiFi.status()!=WL_CONNECTED)return;
  uint32_t now=millis();
  if(channelNoticePending) {
    MeshPacket notice=makeChannelSyncPacket(PACKET_CHANNEL_CHANGE_NOTICE,NODE_ID,255,meshChannel,++channelBeaconSequence,now);
    sendBroadcast(notice);channelNoticePending=false;
  }
  if(now-lastChannelBeaconAt>=CHANNEL_BEACON_INTERVAL_MS) {
    lastChannelBeaconAt=now;
    MeshPacket beacon=makeChannelSyncPacket(PACKET_GATEWAY_BEACON,NODE_ID,255,meshChannel,++channelBeaconSequence,now);
    sendBroadcast(beacon);
  }
  uint8_t synchronized=0;for(uint8_t id=1;id<=3;++id)if(channelSyncAckAt[id]&&now-channelSyncAckAt[id]<=CHANNEL_NODE_LEASE_MS)++synchronized;
  if(synchronized==3&&!meshReadyReported){meshReadyReported=true;Serial.printf("MESH_READY channel=%u synchronized_nodes=3\n",meshChannel);}
  if(synchronized<3)meshReadyReported=false;
}

#define NODE_NAME "ESP32_04"
#define LED_RED 21
#define LED_YELLOW 22
#define LED_GREEN 23
#define LED_COLOR_RED 1
#define LED_COLOR_YELLOW 2
#define LED_COLOR_GREEN 3
#define LED_SUCCESS_HOLD_MS 700UL
#define LED_ACTIVITY_HOLD_MS 250UL
#define LED_ERROR_HOLD_MS 900UL
#define API_URL "https://api.craftiq.in/p12/iot-data"
#define ROUTING_EVENTS_URL "https://api.craftiq.in/p12/routing-events"
#define API_PUBLISH_INTERVAL 5000UL
#define NTP_SYNC_TIMEOUT_MS 15000UL
#define NTP_SYNC_RETRY_MS 30000UL
#define CLOCK_POLL_INTERVAL_MS 250UL
static constexpr time_t MIN_VALID_UTC_EPOCH = 1704067200;
#define WIFI_SSID ""
#define WIFI_PASSWORD ""
#define API_AUTH_TOKEN ""
#define WIFI_TIMEOUT_MS 12000UL
#define WIFI_RETRY_MS 10000UL
#define QUEUE_SIZE 16
#define SEEN_SIZE 64
#define RX_QUEUE_SIZE 24
// ESP32_04 follows its associated AP channel; other nodes discover it by beacon scanning.
#define UPLOAD_TASK_STACK_BYTES 12288

static const char ROOT_CA_CERTIFICATE[] PROGMEM = R"ROOT(-----BEGIN CERTIFICATE-----
MIICCTCCAY6gAwIBAgINAgPlwGjvYxqccpBQUjAKBggqhkjOPQQDAzBHMQswCQYD
VQQGEwJVUzEiMCAGA1UEChMZR29vZ2xlIFRydXN0IFNlcnZpY2VzIExMQzEUMBIG
A1UEAxMLR1RTIFJvb3QgUjQwHhcNMTYwNjIyMDAwMDAwWhcNMzYwNjIyMDAwMDAw
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p/SgguMh1YQdc4acLa/KNJvxn7kjNuK8YAOdgLOaVsjh4rsUecrNIdSUtUlD
-----END CERTIFICATE-----
)ROOT";

static QueueHandle_t rxQueue;
static MeshPacket telemetry[QUEUE_SIZE],latest{};
static MeshPacket routingEvents[QUEUE_SIZE];
static uint8_t qHead=0,qTail=0,qCount=0,seenCursor=0;
static uint8_t routeHead=0,routeCount=0;
static portMUX_TYPE uploadQueueMux=portMUX_INITIALIZER_UNLOCKED;
static SeenKey seen[SEEN_SIZE]{};
static bool espNowReady=false,uploadTaskReady=false;
static bool clockSyncReady=false,clockSyncActive=false,clockSyncAttempted=false;
static uint32_t clockSyncStartedAt=0,lastClockSyncAttemptAt=0,lastClockSyncPollAt=0;
static uint32_t lastPublish=0,lastRoutePublish=0,lastWifiRetry=0,lastStats=0,received=0,duplicates=0,published=0,routePublished=0,apiFailures=0,backpressureRejected=0;
static volatile uint32_t rxQueueOverflows=0;
static int16_t currentRssi=UNKNOWN_I16;
static uint32_t ledRedUntil=0,ledYellowUntil=0,ledGreenUntil=0;
static bool ledRedOn=false,ledYellowOn=false,ledGreenOn=false;
static volatile bool apiUploadActive=false;
static volatile uint32_t apiSuccessEvents=0,apiFailureEvents=0;
static uint32_t observedApiSuccessEvents=0,observedApiFailureEvents=0;
static uint32_t observedRxQueueOverflows=0,observedBackpressureRejected=0;

static void requestStatusLED(uint8_t color,uint32_t holdMs){
  uint32_t until=millis()+holdMs;
  if(color==LED_COLOR_RED)ledRedUntil=until;
  else if(color==LED_COLOR_YELLOW)ledYellowUntil=until;
  else if(color==LED_COLOR_GREEN)ledGreenUntil=until;
}
static void serviceStatusLED(bool errorActive,bool processingActive){
  uint32_t now=millis();
  bool red=errorActive||(int32_t)(ledRedUntil-now)>0;
  bool yellow=!red&&(processingActive||(int32_t)(ledYellowUntil-now)>0);
  bool green=!red&&!yellow&&(int32_t)(ledGreenUntil-now)>0;
  if(red!=ledRedOn)digitalWrite(LED_RED,red?HIGH:LOW);
  if(yellow!=ledYellowOn)digitalWrite(LED_YELLOW,yellow?HIGH:LOW);
  if(green!=ledGreenOn)digitalWrite(LED_GREEN,green?HIGH:LOW);
  ledRedOn=red;ledYellowOn=yellow;ledGreenOn=green;
}

static void countRxQueueOverflow(){__atomic_add_fetch(&rxQueueOverflows,1,__ATOMIC_RELAXED);}
static uint32_t readRxQueueOverflows(){return __atomic_load_n(&rxQueueOverflows,__ATOMIC_RELAXED);}

#if ESP_ARDUINO_VERSION_MAJOR >= 3
static void receiveCallback(const esp_now_recv_info_t *info,const uint8_t *data,int len){
  if(!info||len!=sizeof(MeshPacket))return;RxFrame f{};memcpy(f.mac,info->src_addr,6);memcpy(&f.packet,data,sizeof(MeshPacket));
  f.rssi=info->rx_ctrl?info->rx_ctrl->rssi:UNKNOWN_I16;if(xQueueSend(rxQueue,&f,0)!=pdTRUE)countRxQueueOverflow();
}
#else
static void receiveCallback(const uint8_t *mac,const uint8_t *data,int len){
  if(len!=sizeof(MeshPacket))return;RxFrame f{};memcpy(f.mac,mac,6);memcpy(&f.packet,data,sizeof(MeshPacket));f.rssi=UNKNOWN_I16;
  if(xQueueSend(rxQueue,&f,0)!=pdTRUE)countRxQueueOverflow();
}
#endif
static void remember(const MeshPacket&p){seen[seenCursor]={p.source_id,p.sequence,p.source_uptime_ms};seenCursor=(seenCursor+1)%SEEN_SIZE;}
static bool seenBefore(const MeshPacket&p){for(const auto&k:seen)if(k.source==p.source_id&&k.sequence==p.sequence&&k.uptime==p.source_uptime_ms)return true;return false;}
static void sendAck(uint8_t previous,uint32_t seq,uint32_t uptime,const uint8_t*mac){
  MeshPacket a{};a.version=PROTOCOL_VERSION;a.type=PACKET_ACK;
  copyText(a.project_id,sizeof(a.project_id),PROJECT_ID);copyText(a.network_id,sizeof(a.network_id),NETWORK_ID);copyText(a.experiment_id,sizeof(a.experiment_id),EXPERIMENT_ID);
  a.source_id=NODE_ID;a.destination_id=previous;a.next_hop_id=previous;a.forwarding_node_id=NODE_ID;a.sequence=seq;a.source_uptime_ms=uptime;
  if(addPeer(mac))esp_now_send(mac,reinterpret_cast<const uint8_t*>(&a),sizeof(a));
}
static void sendDeliveryReport(const MeshPacket&p,const uint8_t*mac){
  MeshPacket report{};report.version=PROTOCOL_VERSION;report.type=PACKET_DELIVERY_REPORT;
  copyText(report.project_id,sizeof(report.project_id),PROJECT_ID);copyText(report.network_id,sizeof(report.network_id),NETWORK_ID);
  copyText(report.experiment_id,sizeof(report.experiment_id),EXPERIMENT_ID);
  report.source_id=NODE_ID;report.destination_id=p.source_id;report.next_hop_id=p.source_id;
  report.forwarding_node_id=p.forwarding_node_id;report.routing_algorithm=p.routing_algorithm;
  report.sequence=p.sequence;report.source_uptime_ms=p.source_uptime_ms;
  report.hop_count=p.hop_count<MAX_HOPS?p.hop_count+1:p.hop_count;
  if(addPeer(mac))esp_now_send(mac,reinterpret_cast<const uint8_t*>(&report),sizeof(report));
}
static void sendGatewayProbeAck(const RxFrame&f){
  const MeshPacket&p=f.packet;MeshPacket a{};a.version=PROTOCOL_VERSION;a.type=PACKET_GATEWAY_PROBE_ACK;
  copyText(a.project_id,sizeof(a.project_id),PROJECT_ID);copyText(a.network_id,sizeof(a.network_id),NETWORK_ID);
  copyText(a.experiment_id,sizeof(a.experiment_id),EXPERIMENT_ID);
  a.source_id=NODE_ID;a.destination_id=p.source_id;a.next_hop_id=p.source_id;a.forwarding_node_id=NODE_ID;
  a.sequence=p.sequence;a.source_uptime_ms=p.source_uptime_ms;a.hop_count=p.hop_count+1;
  if(addPeer(f.mac))esp_now_send(f.mac,reinterpret_cast<const uint8_t*>(&a),sizeof(a));
}
static void processIncoming(const RxFrame&f){
  const MeshPacket&p=f.packet;
  if(p.version!=PROTOCOL_VERSION||strncmp(p.project_id,PROJECT_ID,sizeof(p.project_id))||strncmp(p.network_id,NETWORK_ID,sizeof(p.network_id))||strncmp(p.experiment_id,EXPERIMENT_ID,sizeof(p.experiment_id)))return;
  if(isChannelSyncType(p.type)){processChannelSyncFrame(f);return;}
  requestStatusLED(LED_COLOR_GREEN,LED_SUCCESS_HOLD_MS);
  if(p.type==PACKET_GATEWAY_PROBE&&p.destination_id==NODE_ID&&(p.source_id==2||p.source_id==3)){
    sendGatewayProbeAck(f);return;
  }
  if(p.type!=PACKET_DATA||p.next_hop_id!=GATEWAY_ID||p.destination_id!=GATEWAY_ID||p.source_id==NODE_ID||p.source_id<1||p.source_id>3||p.hop_count>=p.hop_limit)return;
  requestStatusLED(LED_COLOR_YELLOW,LED_ACTIVITY_HOLD_MS);
  ++received;currentRssi=f.rssi;
  if(seenBefore(p)){++duplicates;sendAck(p.forwarding_node_id,p.sequence,p.source_uptime_ms,f.mac);sendDeliveryReport(p,f.mac);return;}
  MeshPacket accepted=p;accepted.last_hop_rssi_dbm=f.rssi;++accepted.hop_count;
  bool uploadQueuesFull=false;
  portENTER_CRITICAL(&uploadQueueMux);
  if(qCount>=QUEUE_SIZE||routeCount>=QUEUE_SIZE)uploadQueuesFull=true;
  else{
    telemetry[qTail]=accepted;qTail=(qTail+1)%QUEUE_SIZE;++qCount;
    routingEvents[(routeHead+routeCount)%QUEUE_SIZE]=accepted;++routeCount;
  }
  portEXIT_CRITICAL(&uploadQueueMux);
  if(uploadQueuesFull){
    __atomic_add_fetch(&backpressureRejected,1,__ATOMIC_RELAXED);
    requestStatusLED(LED_COLOR_RED,LED_ERROR_HOLD_MS);
    Serial.printf("UPLOAD_BACKPRESSURE seq=%lu sensor_queue=%u route_queue=%u; not_acked_retry=true\n",
      (unsigned long)p.sequence,queuedTelemetry(),queuedRoutingEvents());
    return;
  }
  latest=accepted;remember(p);
  sendAck(p.forwarding_node_id,p.sequence,p.source_uptime_ms,f.mac);
  sendDeliveryReport(p,f.mac);
  Serial.printf("GATEWAY_DELIVERY seq=%lu src=%u relay=%u mode=%s routing_algorithm=%u result=received hop_count=%u\n",
    (unsigned long)p.sequence,p.source_id,p.forwarding_node_id,
    p.routing_algorithm==ROUTING_ML_UPPER||p.routing_algorithm==ROUTING_ML_LOWER?"ML_ACTIVE":"BASELINE_FALLBACK",
    p.routing_algorithm,accepted.hop_count);
}
static void serviceRx(){
  RxFrame f{};while(xQueueReceive(rxQueue,&f,0)==pdTRUE)processIncoming(f);
}
static String metricI16(int16_t v){return v==UNKNOWN_I16?String("null"):String(v);}
static String metricU16(uint16_t v){return v==UNKNOWN_U16?String("null"):String(v);}
static String metricU32(uint32_t v){return v==UNKNOWN_U32?String("null"):String(v);}
static String makeJson(const MeshPacket&p){
  String j;j.reserve(560);j+="{";
  j+="\"projectId\":\"";j+=PROJECT_ID;j+="\",\"networkId\":\"";j+=NETWORK_ID;
  j+="\",\"provenance\":\"live_hardware\"";
  j+=",\"experimentId\":\"";j+=p.experiment_id;j+="\",\"sourceNodeId\":";j+=String(p.source_id);
  j+=",\"gatewayNodeId\":4,\"forwardingNodeId\":";j+=String(p.forwarding_node_id);
  j+=",\"nextHopId\":4,\"routingAlgorithm\":";j+=String(p.routing_algorithm);
  j+=",\"sequence\":";j+=String(p.sequence);j+=",\"sourceUptimeMs\":";j+=String(p.source_uptime_ms);
  j+=",\"hopCount\":";j+=String(p.hop_count);j+=",\"temperatureC\":";
  j+=p.temperature_centi_c==UNKNOWN_I16?String("null"):String(p.temperature_centi_c/100.0f,2);
  j+=",\"humidityPercent\":";j+=p.humidity_centi_percent==UNKNOWN_U16?String("null"):String(p.humidity_centi_percent/100.0f,2);
  j+=",\"lightStatus\":";j+=p.light_status==LIGHT_UNKNOWN?String("null"):String(p.light_status);
  j+=",\"soundDetected\":";j+=p.sound_detected==LIGHT_UNKNOWN?String("null"):p.sound_detected?String("true"):String("false");
  j+=",\"rssiDbm\":";j+=metricI16(p.last_hop_rssi_dbm);j+=",\"latencyMs\":";j+=metricU16(p.latency_ms);
  j+=",\"packetLossPercent\":";j+=p.packet_loss_percent==255?String("null"):String(p.packet_loss_percent);
  j+=",\"throughputBps\":";j+=metricU32(p.throughput_bps);j+="}";return j;
}
static String reasonName(uint8_t code){switch(code){case 1:return "model_class_upper";case 2:return "model_class_lower";case 3:return "required_candidate_metrics_missing_or_stale";case 4:return "both_paths_unavailable";case 5:return "model_no_usable_route";case 6:return "baseline_experiment_override";default:return "other_or_unchanged";}}
static String modeName(uint8_t mode){switch(mode){case ROUTING_ML_UPPER:case ROUTING_ML_LOWER:return "ML_ACTIVE";case ROUTING_NO_VALID_ROUTE:return "NO_VALID_ROUTE";default:return "BASELINE_FALLBACK";}}
static String featureJson(float v){return isfinite(v)?String(v,5):String("null");}
static String makeRoutingJson(const MeshPacket&p){
  String j;j.reserve(720);j+="{\"projectId\":\"P12-IOT\",\"networkId\":\"P12-MESH-01\",\"experimentId\":\"";j+=p.experiment_id;j+="\"";
  j+=",\"sourceNodeId\":";j+=String(p.source_id);j+=",\"currentNodeId\":";j+=String(p.source_id);
  j+=",\"selectedNextHopId\":";j+=String(p.selected_next_hop_id);j+=",\"forwardingNodeId\":";j+=String(p.forwarding_node_id);
  j+=",\"sequence\":";j+=String(p.sequence);j+=",\"sourceUptimeMs\":";j+=String(p.source_uptime_ms);
  j+=",\"routingMode\":\"";j+=modeName(p.routing_algorithm);j+="\",\"featureValid\":";j+=p.feature_valid?"true":"false";
  j+=",\"predictedClass\":";j+=(p.feature_valid&&p.predicted_class>=-1&&p.predicted_class<=1)?String((int)p.predicted_class):String("null");
  j+=",\"candidateUpper\":{\"available\":";j+=isfinite(p.model_features[0])?(p.model_features[0]>=0.5?"true":"false"):"null";j+=",\"pdr\":";j+=featureJson(p.model_features[1]);j+=",\"latencyMs\":";j+=featureJson(p.model_features[2]);j+=",\"hops\":";j+=featureJson(p.model_features[3]);j+="}";
  j+=",\"candidateLower\":{\"available\":";j+=isfinite(p.model_features[4])?(p.model_features[4]>=0.5?"true":"false"):"null";j+=",\"pdr\":";j+=featureJson(p.model_features[5]);j+=",\"latencyMs\":";j+=featureJson(p.model_features[6]);j+=",\"hops\":";j+=featureJson(p.model_features[7]);j+="}";
  j+=",\"modelFeatures\":[";for(uint8_t i=0;i<8;++i){if(i)j+=",";j+=featureJson(p.model_features[i]);}j+="]";
  j+=",\"forwardingResult\":\"GATEWAY_RECEIVED\",\"ackResult\":\"NOT_OBSERVED\",\"hopCount\":";j+=String(p.hop_count);
  j+=",\"routeChanged\":";j+=p.route_change?"true":"false";j+=",\"routeChangeReason\":\"";j+=reasonName(p.route_change_reason);j+="\",\"sourcePacketsSent\":";j+=String(p.source_packets_sent);j+="}";return j;
}
static const char* apiEndpointName(const char*url){
  return strstr(url,"/routing-events")?"routing_events":"iot_data";
}
static const char* httpStatusName(int status){
  if(status>=200&&status<300)return "success";
  if(status==401)return "unauthorized";
  if(status==403)return "forbidden";
  if(status==404)return "not_found";
  if(status==422)return "validation_error";
  if(status==429)return "rate_limited";
  if(status>=500)return "server_error";
  if(status>=400)return "client_error";
  return "unknown";
}
static const char* transportErrorName(int status){
  if(status==HTTPC_ERROR_READ_TIMEOUT)return "timeout";
  if(status==HTTPC_ERROR_CONNECTION_REFUSED)return "connect_failed";
  if(status==HTTPC_ERROR_NOT_CONNECTED||status==HTTPC_ERROR_CONNECTION_LOST)return "connection_lost";
  if(status==HTTPC_ERROR_SEND_HEADER_FAILED||status==HTTPC_ERROR_SEND_PAYLOAD_FAILED)return "send_failed";
  if(status==HTTPC_ERROR_NO_STREAM||status==HTTPC_ERROR_NO_HTTP_SERVER)return "no_http_response";
  return "transport_error";
}
static const char* postFailurePhase(int status,const P12TrackedTlsClient&tls){
  if(status==HTTPC_ERROR_CONNECTION_REFUSED)
    return tls.connectResult==1?"socket_disconnected_before_http_send":"connect_or_tls_handshake";
  if(status==HTTPC_ERROR_SEND_HEADER_FAILED)return "request_header_write";
  if(status==HTTPC_ERROR_SEND_PAYLOAD_FAILED)return "request_body_write";
  if(status==HTTPC_ERROR_NOT_CONNECTED)return "socket_not_connected";
  if(status==HTTPC_ERROR_CONNECTION_LOST)return "socket_lost_while_reading_response";
  if(status==HTTPC_ERROR_NO_HTTP_SERVER)return "malformed_or_missing_http_status_line";
  if(status==HTTPC_ERROR_READ_TIMEOUT)return "response_read_timeout";
  if(status==HTTPC_ERROR_NO_STREAM)return "response_stream_unavailable";
  return "httpclient_transport";
}
static const char* postFailureClass(int status,int tlsCode,const P12TrackedTlsClient&tls){
  if(status==HTTPC_ERROR_CONNECTION_REFUSED&&tlsCode==-0x0050)
    return tls.connectResult==1?"peer_reset_before_http_send":"peer_reset_during_connect";
  if(status==HTTPC_ERROR_SEND_HEADER_FAILED)return "request_header_write_failed";
  if(status==HTTPC_ERROR_SEND_PAYLOAD_FAILED)return "request_body_write_failed";
  if(status==HTTPC_ERROR_CONNECTION_LOST)return "socket_reset_or_closed_while_reading";
  if(status==HTTPC_ERROR_READ_TIMEOUT)return "response_timeout";
  if(status==HTTPC_ERROR_NO_HTTP_SERVER)return "malformed_http_response";
  if(status==HTTPC_ERROR_CONNECTION_REFUSED)return tls.connectResult==1?"socket_closed_before_http_send":"tcp_or_tls_connect_failed";
  return transportErrorName(status);
}
static void logTlsHeap(const char*endpoint){
  const uint32_t freeInternal=heap_caps_get_free_size(MALLOC_CAP_INTERNAL|MALLOC_CAP_8BIT);
  const uint32_t largestInternal=heap_caps_get_largest_free_block(MALLOC_CAP_INTERNAL|MALLOC_CAP_8BIT);
  const uint32_t free8Bit=heap_caps_get_free_size(MALLOC_CAP_8BIT);
  const uint32_t largest8Bit=heap_caps_get_largest_free_block(MALLOC_CAP_8BIT);
  Serial.printf("TLS_HEAP endpoint=%s free_internal=%lu largest_internal=%lu free_8bit=%lu largest_8bit=%lu\n",
    endpoint,(unsigned long)freeInternal,(unsigned long)largestInternal,(unsigned long)free8Bit,(unsigned long)largest8Bit);
}
static String sanitizeApiLogText(String value){
  if(strlen(API_AUTH_TOKEN)>0)value.replace(API_AUTH_TOKEN,"[REDACTED]");
  const char* sensitiveKeys[]={"authorization","token","password","secret","apikey"};
  for(const char*key:sensitiveKeys){
    String needle=String("\"")+key+"\"";
    for(;;){
      String lower=value;lower.toLowerCase();int keyAt=lower.indexOf(needle);if(keyAt<0)break;
      int colon=lower.indexOf(':',keyAt+needle.length());if(colon<0)break;
      int start=colon+1;while(start<(int)value.length()&&isspace((unsigned char)value[start]))++start;
      int end=start;
      if(start<(int)value.length()&&value[start]=='\"'){
        ++start;end=start;bool escaped=false;
        while(end<(int)value.length()){
          char c=value[end];if(c=='\"'&&!escaped)break;
          if(c=='\\'&&!escaped)escaped=true;else escaped=false;++end;
        }
      }else{
        while(end<(int)value.length()&&value[end]!=','&&value[end]!='}'&&!isspace((unsigned char)value[end]))++end;
      }
      value=value.substring(0,start)+"[REDACTED]"+value.substring(end);
    }
  }
  String lower=value;lower.toLowerCase();int bearer=lower.indexOf("bearer ");
  if(bearer>=0){int start=bearer+7,end=start;while(end<(int)value.length()&&!isspace((unsigned char)value[end])&&value[end]!='\"'&&value[end]!=','&&value[end]!='}')++end;value=value.substring(0,start)+"[REDACTED]"+value.substring(end);}
  for(size_t i=0;i<value.length();++i)if((unsigned char)value[i]<32||(unsigned char)value[i]>126)value.setCharAt(i,' ');
  if(value.length()>240)value=value.substring(0,240)+"...";
  return value;
}
static bool postJson(const char*url,const String&body){
  const char*endpoint=apiEndpointName(url);
  const uint32_t requestStarted=millis();
  const size_t requestBytes=body.length();
  if(WiFi.status()!=WL_CONNECTED){Serial.printf("API_CONNECT_ERROR endpoint=%s reason=wifi_disconnected request_sent=false\n",endpoint);return false;}
  if(!clockSyncReady||!systemClockValid()){
    clockSyncReady=false;
    Serial.printf("API_CLOCK_NOT_READY endpoint=%s request_sent=false queue_retained=true\n",endpoint);
    return false;
  }
  if(String(API_AUTH_TOKEN).length()==0||String(API_AUTH_TOKEN)=="SET_P12_IOT_BEARER_TOKEN"){
    Serial.printf("API_AUTH_CONFIG_ERROR endpoint=%s reason=token_placeholder request_sent=false\n",endpoint);return false;
  }
  if(requestBytes<2||body[0]!='{'||body[requestBytes-1]!='}'){
    Serial.printf("API_PAYLOAD_ERROR endpoint=%s bytes=%u reason=not_json_object request_sent=false\n",endpoint,(unsigned)requestBytes);return false;
  }
  logTlsHeap(endpoint);
  Serial.printf("API_REQUEST_PREP endpoint=%s bytes=%u content_type=application/json auth=bearer tls=verified hostname=%s connection=fresh\n",
    endpoint,(unsigned)requestBytes,API_HOST);
  P12TrackedTlsClient tls;
  tls.setCACert(ROOT_CA_CERTIFICATE);
  tls.setTimeout(8000);
  HTTPClient http;
  http.setReuse(false);
  http.setConnectTimeout(8000);
  http.setTimeout(8000);
  if(!http.begin(tls,url)){
    char tlsDetail[128]{};int tlsCode=tls.lastError(tlsDetail,sizeof(tlsDetail));
    Serial.printf("API_HTTP_BEGIN_ERROR endpoint=%s tls_code=%d tls_detail=%s request_sent=false bytes=%u\n",
      endpoint,tlsCode,sanitizeApiLogText(String(tlsDetail)).c_str(),(unsigned)requestBytes);
    http.end();tls.stop();return false;
  }
  http.addHeader("Content-Type","application/json");
  http.addHeader("Authorization",String("Bearer ")+API_AUTH_TOKEN);
  Serial.printf("API_HTTP_POST_START endpoint=%s body_bytes=%u content_type=application/json auth=bearer host=%s content_length=automatic connection=close tls=verified connect=HTTPClient\n",
    endpoint,(unsigned)requestBytes,API_HOST);
  const int status=http.POST(body);
  String response=status>0?http.getString():"";
  if(status<0){
    char tlsDetail[128]{};int tlsCode=tls.lastError(tlsDetail,sizeof(tlsDetail));
    const char*failurePhase=postFailurePhase(status,tls);
    const char*failureClass=postFailureClass(status,tlsCode,tls);
    String detail=tlsCode!=0?sanitizeApiLogText(String(tlsDetail)):sanitizeApiLogText(http.errorToString(status));
    Serial.printf("API_HTTP_TRANSPORT_ERROR endpoint=%s phase=%s class=%s httpclient_code=%d detail=%s tls_code=%d tls_detail=%s connect_attempts=%lu connect_result=%d connect_ms=%lu header_written=%u/%u body_attempted=%u body_written=%u/%u request_sent=%s elapsed_ms=%lu\n",
      endpoint,failurePhase,failureClass,status,detail.c_str(),tlsCode,sanitizeApiLogText(String(tlsDetail)).c_str(),
      (unsigned long)tls.connectAttempts,tls.connectResult,(unsigned long)tls.connectElapsedMs,
      (unsigned)tls.headerBytesWritten,(unsigned)tls.headerBytesAttempted,
      (unsigned)tls.bodyBytesAttempted,(unsigned)tls.bodyBytesWritten,(unsigned)requestBytes,tls.bodyBytesWritten==requestBytes?"yes":"no",
      (unsigned long)(millis()-requestStarted));
  }else{
    const bool success=response.indexOf("\"success\":true")>=0;
    Serial.printf("API_HTTP_RESPONSE endpoint=%s status=%d class=%s connect_attempts=%lu connect_result=%d header_written=%u/%u body_attempted=%u body_written=%u/%u response_bytes=%u body=%s elapsed_ms=%lu\n",
      endpoint,status,httpStatusName(status),(unsigned long)tls.connectAttempts,tls.connectResult,
      (unsigned)tls.headerBytesWritten,(unsigned)tls.headerBytesAttempted,
      (unsigned)tls.bodyBytesAttempted,(unsigned)tls.bodyBytesWritten,(unsigned)requestBytes,
      (unsigned)response.length(),sanitizeApiLogText(response).c_str(),
      (unsigned long)(millis()-requestStarted));
    if(status>=200&&status<300&&!success)
      Serial.printf("API_RESPONSE_PARSE_ERROR endpoint=%s status=%d reason=success_flag_missing response_bytes=%u\n",
        endpoint,status,(unsigned)response.length());
    else if(status<200||status>=300)
      Serial.printf("API_HTTP_FAILURE endpoint=%s status=%d class=%s request_bytes=%u\n",
        endpoint,status,httpStatusName(status),(unsigned)requestBytes);
  }
  http.end();tls.stop();
  return status>=200&&status<300&&response.indexOf("\"success\":true")>=0;
}
static bool publishOne(const MeshPacket&p){return postJson(API_URL,makeJson(p));}
static bool publishRoutingEvent(const MeshPacket&p){return postJson(ROUTING_EVENTS_URL,makeRoutingJson(p));}
static bool peekTelemetry(MeshPacket&out){
  bool found=false;portENTER_CRITICAL(&uploadQueueMux);
  if(qCount){out=telemetry[qHead];found=true;}
  portEXIT_CRITICAL(&uploadQueueMux);return found;
}
static bool peekRoutingEvent(MeshPacket&out){
  bool found=false;portENTER_CRITICAL(&uploadQueueMux);
  if(routeCount){out=routingEvents[routeHead];found=true;}
  portEXIT_CRITICAL(&uploadQueueMux);return found;
}
static uint8_t queuedTelemetry(){uint8_t count;portENTER_CRITICAL(&uploadQueueMux);count=qCount;portEXIT_CRITICAL(&uploadQueueMux);return count;}
static uint8_t queuedRoutingEvents(){uint8_t count;portENTER_CRITICAL(&uploadQueueMux);count=routeCount;portEXIT_CRITICAL(&uploadQueueMux);return count;}
static bool sameQueuePacket(const MeshPacket&a,const MeshPacket&b){
  return a.source_id==b.source_id&&a.sequence==b.sequence&&a.source_uptime_ms==b.source_uptime_ms;
}
static void removePublishedTelemetry(const MeshPacket&p){
  portENTER_CRITICAL(&uploadQueueMux);
  if(qCount&&sameQueuePacket(telemetry[qHead],p)){qHead=(qHead+1)%QUEUE_SIZE;--qCount;}
  portEXIT_CRITICAL(&uploadQueueMux);
}
static void removePublishedRoutingEvent(const MeshPacket&p){
  portENTER_CRITICAL(&uploadQueueMux);
  if(routeCount&&sameQueuePacket(routingEvents[routeHead],p)){routeHead=(routeHead+1)%QUEUE_SIZE;--routeCount;}
  portEXIT_CRITICAL(&uploadQueueMux);
}
static void reconnectWiFi(){
  if(millis()-lastWifiRetry<WIFI_RETRY_MS)return;lastWifiRetry=millis();
  if(String(WIFI_SSID)=="SET_WIFI_SSID"||strlen(WIFI_SSID)==0)return;
  WiFi.begin(WIFI_SSID,WIFI_PASSWORD);
}
static void serviceWiFi(){
  bool wasReady=wifiReady;
  wifiReady=WiFi.status()==WL_CONNECTED;
  if(wifiReady){
    uint8_t apChannel=WiFi.channel();
    if(apChannel>=1&&apChannel<=13&&apChannel!=meshChannel){
      uint8_t oldChannel=meshChannel;previousMeshChannel=oldChannel;meshChannel=apChannel;
      memset(channelSyncAckAt,0,sizeof(channelSyncAckAt));meshReadyReported=false;channelNoticePending=true;
      Serial.printf("WIFI_CHANNEL_CHANGED old_channel=%u new_channel=%u\n",oldChannel,meshChannel);
      Serial.printf("MESH_RESYNC_START channel=%u\n",meshChannel);
    }
    if(!wasReady){
      memset(channelSyncAckAt,0,sizeof(channelSyncAckAt));meshReadyReported=false;channelNoticePending=true;
      Serial.printf("WIFI_CONNECTED channel=%u\n",meshChannel);
      Serial.printf("MESH_RESYNC_START channel=%u reason=wifi_reconnected\n",meshChannel);
    }
  }else if(wasReady){
    memset(channelSyncAckAt,0,sizeof(channelSyncAckAt));meshReadyReported=false;
    Serial.println("CLOUD_OUTAGE reason=wifi_link_lost; mesh_beacons_paused; queued_uploads_retained");
  }
  if(!wifiReady)reconnectWiFi();
}
static bool systemClockValid(){return time(nullptr)>=MIN_VALID_UTC_EPOCH;}
static void serviceClockSync(){
  uint32_t now=millis();time_t utcNow=time(nullptr);
  if(utcNow>=MIN_VALID_UTC_EPOCH){
    if(!clockSyncReady)Serial.printf("CLOCK_SYNC_OK timezone=UTC epoch=%lld\n",(long long)utcNow);
    clockSyncReady=true;clockSyncActive=false;return;
  }
  if(clockSyncReady){clockSyncReady=false;Serial.println("CLOCK_SYNC_LOST https_blocked=true");}
  if(WiFi.status()!=WL_CONNECTED)return;
  if(!clockSyncActive){
    if(clockSyncAttempted&&now-lastClockSyncAttemptAt<NTP_SYNC_RETRY_MS)return;
    configTime(0,0,"pool.ntp.org","time.google.com","time.cloudflare.com");
    clockSyncAttempted=true;clockSyncActive=true;clockSyncStartedAt=now;
    lastClockSyncAttemptAt=now;lastClockSyncPollAt=now-CLOCK_POLL_INTERVAL_MS;
    Serial.printf("CLOCK_SYNC_START timezone=UTC timeout_ms=%lu\n",(unsigned long)NTP_SYNC_TIMEOUT_MS);
  }
  now=millis();
  if(now-lastClockSyncPollAt<CLOCK_POLL_INTERVAL_MS&&now-clockSyncStartedAt<NTP_SYNC_TIMEOUT_MS)return;
  lastClockSyncPollAt=now;utcNow=time(nullptr);
  if(utcNow>=MIN_VALID_UTC_EPOCH){
    clockSyncReady=true;clockSyncActive=false;
    Serial.printf("CLOCK_SYNC_OK timezone=UTC epoch=%lld\n",(long long)utcNow);return;
  }
  if(now-clockSyncStartedAt>=NTP_SYNC_TIMEOUT_MS){
    clockSyncActive=false;
    Serial.printf("CLOCK_SYNC_TIMEOUT timeout_ms=%lu retry_after_ms=%lu https_blocked=true queues_retained=true\n",
      (unsigned long)NTP_SYNC_TIMEOUT_MS,(unsigned long)NTP_SYNC_RETRY_MS);
  }
}
static void initWifi(){
  WiFi.mode(WIFI_STA);WiFi.setSleep(false);
  if(String(WIFI_SSID)!="SET_WIFI_SSID"&&strlen(WIFI_SSID)){
    WiFi.begin(WIFI_SSID,WIFI_PASSWORD);uint32_t start=millis();
    while(WiFi.status()!=WL_CONNECTED&&millis()-start<WIFI_TIMEOUT_MS)delay(100);
  }
  if(WiFi.status()==WL_CONNECTED){
    wifiReady=true;meshChannel=WiFi.channel();
    Serial.printf("WIFI_CONNECTED channel=%u\n",meshChannel);
    Serial.printf("GATEWAY_CHANNEL_SET channel=%u source=associated_ap\n",meshChannel);
  }else{
    wifiReady=false;uint8_t radioChannel=0;wifi_second_chan_t second;
    if(esp_wifi_get_channel(&radioChannel,&second)==ESP_OK&&radioChannel>=1&&radioChannel<=13)meshChannel=radioChannel;
    else meshChannel=MESH_BOOT_CHANNEL;
    Serial.printf("CLOUD_OUTAGE reason=wifi_unavailable_at_start; mesh_channel=%u; beacons_wait_for_ap; queued_uploads_retained\n",meshChannel);
  }
}
static void uploadTask(void*){
  for(;;){
    serviceClockSync();
    uint32_t now=millis();
    const bool sensorDue=now-lastPublish>=API_PUBLISH_INTERVAL;
    const bool routeDue=now-lastRoutePublish>=API_PUBLISH_INTERVAL;
    if(sensorDue||routeDue){
      if(sensorDue)lastPublish=now;
      if(routeDue)lastRoutePublish=now;
      if(WiFi.status()==WL_CONNECTED&&!clockSyncReady){
        if(queuedTelemetry()||queuedRoutingEvents())
          Serial.printf("UPLOAD_DEFERRED reason=clock_unsynced sensor_queue=%u route_queue=%u; retained=true\n",queuedTelemetry(),queuedRoutingEvents());
      }else{
        bool sensorBlocked=false,routeBlocked=false;
        for(;;){
        bool progressed=false;MeshPacket p{};
        if(sensorDue&&!sensorBlocked&&peekTelemetry(p)){
          if(WiFi.status()!=WL_CONNECTED){
            Serial.printf("API_OFFLINE sensor_queue=%u route_queue=%u; retained\n",queuedTelemetry(),queuedRoutingEvents());sensorBlocked=true;
          }else{
            __atomic_store_n(&apiUploadActive,true,__ATOMIC_RELAXED);
            bool uploadSucceeded=publishOne(p);
            __atomic_store_n(&apiUploadActive,false,__ATOMIC_RELAXED);
            if(uploadSucceeded){
            __atomic_add_fetch(&apiSuccessEvents,1,__ATOMIC_RELAXED);
            removePublishedTelemetry(p);__atomic_add_fetch(&published,1,__ATOMIC_RELAXED);progressed=true;
            Serial.printf("API_PUBLISHED seq=%lu queued=%u\n",(unsigned long)p.sequence,queuedTelemetry());
            }else{
            __atomic_add_fetch(&apiFailureEvents,1,__ATOMIC_RELAXED);
            uint32_t failures=__atomic_add_fetch(&apiFailures,1,__ATOMIC_RELAXED);sensorBlocked=true;
            Serial.printf("API_RETRY seq=%lu failures=%lu queued=%u; retained_until_next_5s_cycle\n",(unsigned long)p.sequence,(unsigned long)failures,queuedTelemetry());
            }
          }
        }
        if(routeDue&&!routeBlocked&&peekRoutingEvent(p)){
          if(WiFi.status()!=WL_CONNECTED){
            Serial.printf("ROUTING_API_OFFLINE queued=%u; retained\n",queuedRoutingEvents());routeBlocked=true;
          }else{
            __atomic_store_n(&apiUploadActive,true,__ATOMIC_RELAXED);
            bool uploadSucceeded=publishRoutingEvent(p);
            __atomic_store_n(&apiUploadActive,false,__ATOMIC_RELAXED);
            if(uploadSucceeded){
            __atomic_add_fetch(&apiSuccessEvents,1,__ATOMIC_RELAXED);
            removePublishedRoutingEvent(p);__atomic_add_fetch(&routePublished,1,__ATOMIC_RELAXED);progressed=true;
            Serial.printf("ROUTING_EVENT_PUBLISHED seq=%lu queued=%u\n",(unsigned long)p.sequence,queuedRoutingEvents());
            }else{
            __atomic_add_fetch(&apiFailureEvents,1,__ATOMIC_RELAXED);
            uint32_t failures=__atomic_add_fetch(&apiFailures,1,__ATOMIC_RELAXED);routeBlocked=true;
            Serial.printf("ROUTING_EVENT_RETRY seq=%lu failures=%lu queued=%u; retained_until_next_5s_cycle\n",(unsigned long)p.sequence,(unsigned long)failures,queuedRoutingEvents());
            }
          }
        }
          if(!progressed)break;
        }
      }
    }
    vTaskDelay(pdMS_TO_TICKS(10));
  }
}
void setup(){
  Serial.begin(115200);
  pinMode(LED_RED,OUTPUT);pinMode(LED_YELLOW,OUTPUT);pinMode(LED_GREEN,OUTPUT);
  digitalWrite(LED_RED,LOW);digitalWrite(LED_YELLOW,LOW);digitalWrite(LED_GREEN,LOW);
  WiFi.mode(WIFI_STA);rxQueue=xQueueCreate(RX_QUEUE_SIZE,sizeof(RxFrame));
  if(!rxQueue){Serial.println("ERROR rx_queue");while(true)delay(1000);}
  initWifi();if(esp_now_init()!=ESP_OK){Serial.println("ERROR esp_now_init");while(true)delay(1000);}
  addPeer(BROADCAST_MAC);esp_now_register_recv_cb(receiveCallback);
  espNowReady=true;lastPublish=millis()-API_PUBLISH_INTERVAL;lastRoutePublish=millis()-API_PUBLISH_INTERVAL;
  // Lower priority than Arduino loop task; HTTP/TLS cannot starve its ESP-NOW queue drain.
  uploadTaskReady=xTaskCreatePinnedToCore(uploadTask,"p12_upload",UPLOAD_TASK_STACK_BYTES,nullptr,0,nullptr,1)==pdPASS;
  if(!uploadTaskReady)
    Serial.println("CLOUD_OUTAGE reason=upload_task_create_failed; mesh_receiving_without_api_upload");
  Serial.printf("READY %s channel=%u wifi=%s cloud=%s api=%s\n",NODE_NAME,meshChannel,wifiReady?"online":"offline",(wifiReady&&uploadTaskReady)?"upload_ready":"offline",API_URL);
}
void loop(){
  serviceWiFi();serviceRx();serviceChannelSync();
  uint32_t successes=__atomic_load_n(&apiSuccessEvents,__ATOMIC_RELAXED);
  uint32_t failures=__atomic_load_n(&apiFailureEvents,__ATOMIC_RELAXED);
  uint32_t overflows=readRxQueueOverflows();
  uint32_t rejected=__atomic_load_n(&backpressureRejected,__ATOMIC_RELAXED);
  if(successes!=observedApiSuccessEvents){observedApiSuccessEvents=successes;requestStatusLED(LED_COLOR_GREEN,LED_SUCCESS_HOLD_MS);}
  if(failures!=observedApiFailureEvents){observedApiFailureEvents=failures;requestStatusLED(LED_COLOR_RED,LED_ERROR_HOLD_MS);}
  if(overflows!=observedRxQueueOverflows){observedRxQueueOverflows=overflows;requestStatusLED(LED_COLOR_RED,LED_ERROR_HOLD_MS);}
  if(rejected!=observedBackpressureRejected){observedBackpressureRejected=rejected;requestStatusLED(LED_COLOR_RED,LED_ERROR_HOLD_MS);}
  serviceStatusLED(!wifiReady,__atomic_load_n(&apiUploadActive,__ATOMIC_RELAXED)||uxQueueMessagesWaiting(rxQueue)>0);
  if(millis()-lastStats>=10000){lastStats=millis();Serial.printf("GATEWAY_STATUS node=4 wifi=%s cloud=%s channel=%u espnow=%s api_ok=%lu route_api_ok=%lu api_fail=%lu sensor_queue=%u route_queue=%u rx=%lu rx_queue_overflow=%lu dup=%lu backpressure_rejected=%lu latest_src=%u latest_seq=%lu rssi=%d\n",
    wifiReady?"online":"offline",(wifiReady&&uploadTaskReady)?"upload_ready":"offline",WiFi.channel(),espNowReady?"ready":"error",(unsigned long)__atomic_load_n(&published,__ATOMIC_RELAXED),(unsigned long)__atomic_load_n(&routePublished,__ATOMIC_RELAXED),(unsigned long)__atomic_load_n(&apiFailures,__ATOMIC_RELAXED),queuedTelemetry(),queuedRoutingEvents(),(unsigned long)received,(unsigned long)readRxQueueOverflows(),(unsigned long)duplicates,(unsigned long)__atomic_load_n(&backpressureRejected,__ATOMIC_RELAXED),
    latest.source_id,(unsigned long)latest.sequence,currentRssi);}
  delay(1);
}
